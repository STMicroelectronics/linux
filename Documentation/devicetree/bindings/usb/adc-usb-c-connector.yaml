## Documentation/devicetree/bindings/usb/adc-usb-c-connector.yaml
```yaml
# SPDX-License-Identifier: (GPL-2.0-only OR BSD-2-Clause)
%YAML 1.2
---
$id: http://devicetree.org/schemas/usb/adc-usb-c-connector.yaml#
$schema: http://devicetree.org/meta-schemas/core.yaml#

title: ADC based Type-C controller

maintainers:
  - Ram Dayal <ram.dayal@st.com>

description: |
  This binding describes the ADC based Type-C controller with ADC monitoring with CC lines.

properties:
  compatible:
    const: adc-usb-c-connector

  io-channels:
    description: List of phandles to the IIO channels for CC1 and CC2.
    items:
      - description: Phandle to the IIO channel for CC1.
      - description: Phandle to the IIO channel for CC2.

  io-channel-names:
    description: Names of the IIO channels.
    items:
      - const: cc1
      - const: cc2

  connector:
    type: object
    $ref: /schemas/connector/usb-connector.yaml#
    description: USB Type-C connector properties.

required:
  - compatible
  - io-channels
  - io-channel-names
  - connector

additionalProperties: false

examples:
  - |
    typec {
        compatible = "adc-usb-c-connector";
        io-channels = <&adc 0>, <&adc 1>;
        io-channel-names = "cc1", "cc2";

        connector {
            compatible = "usb-c-connector";
            label = "USB-C";
            data-role = "device";
            power-role = "sink";
            port {
                usb_c_port: endpoint {
                    remote-endpoint = <&usb_c_device_port>;
                };
            };
        };
    };
```

## Documentation/devicetree/bindings/usb/stm32,dwc3.yaml
```yaml
# SPDX-License-Identifier: (GPL-2.0 OR BSD-2-Clause)
%YAML 1.2
---
$id: http://devicetree.org/schemas/usb/stm32,dwc3.yaml#
$schema: http://devicetree.org/meta-schemas/core.yaml#

title: STMicroelectronics STM32 MPU DWC3 USB SoC controller

description:
  The STM32 MPU DWC3 USB SoC controller block supports both Host(SS/HS/FS/LS)
  or Device(SS/HS/FS) mode operation

maintainers:
  - Fabrice Gasnier <fabrice.gasnier@foss.st.com>

properties:
  compatible:
    const: st,stm32mp25-dwc3

  "#address-cells":
    const: 1

  "#size-cells":
    const: 1

  ranges: true

  st,syscfg:
    $ref: /schemas/types.yaml#/definitions/phandle-array #(arm/stm32/st,stm32-syscon.yaml#)
    description: <Phandle to the STM32-MPU System Controller DT node> <offset-for-usr3drcr-reg>

  st,vbusen-active-low:
    type: boolean
    description: VBUS-ENABLE signal polarity is active-low

  st,ovrcur-active-low:
    type: boolean
    description: Over-Current signal polarity is active-low

  st,enable-port-power-control:
    type: boolean
    description: Enable Host-Mode Port Power Control (bit-3 of capability param HCCPARAMS)

  wakeup-source: true

  interrupts:
    maxItems: 1
    description: interrupt used for wakeup

  feature-domains:
    $ref: /schemas/types.yaml#/definitions/phandle-array
    description: |
      Phandle to the rifsc device to check access right.

# Required child node:

patternProperties:
  "^usb@[0-9a-f]+$":
    $ref: snps,dwc3.yaml#

required:
  - compatible
  - "#address-cells"
  - "#size-cells"
  - ranges
  - st,syscfg

allOf:
  - if:
      required:
        - wakeup-source
    then:
      anyOf:
        - required: [interrupts]
        - required: [interrupts-extended]

additionalProperties: false

examples:
  - |
    #include <dt-bindings/clock/stm32mp25-clks.h>
    #include <dt-bindings/interrupt-controller/arm-gic.h>
    #include <dt-bindings/reset/stm32mp25-resets.h>

    usb3dr: usb@48300000 {
        compatible      = "st,stm32mp25-dwc3";
        st,syscfg       = <&syscfg 0x4800>;
        #address-cells  = <1>;
        #size-cells     = <1>;
        ranges = <0x48300000 0x48300000 0x100000>;
        st,ovrcur-active-low;
        st,vbusen-active-low;
        wakeup-source;
        interrupts-extended = <&exti1 44 IRQ_TYPE_EDGE_RISING>;

        dwc3: usb@48300000 {
            compatible      = "snps,dwc3";
            reg             = <0x48300000 0x100000>;
            interrupts      = <GIC_SPI 228 IRQ_TYPE_LEVEL_HIGH>;
            clock-names     = "ref", "bus_early", "suspend";
            clocks          = <&rcc CK_KER_USB2PHY2>, <&rcc CK_BUS_USB3DR>,
                              <&rcc CK_KER_USB2PHY2>;
            resets          = <&rcc USB3DR_R>;
            phys            = <&usb2_phy>, <&usb3_phy>;
            phy-names       = "usb2-phy", "usb3-phy";
            wakeup-source;
        };
    };
```

## Documentation/devicetree/bindings/usb/stm32,usbh.yaml
```yaml
# SPDX-License-Identifier: (GPL-2.0 OR BSD-2-Clause)
%YAML 1.2
---
$id: http://devicetree.org/schemas/usb/stm32,usbh.yaml#
$schema: http://devicetree.org/meta-schemas/core.yaml#

title: STMicroelectronics STM32 MPU USB2 Host SoC controller

maintainers:
  - Pankaj Dev <pankaj.dev@st.com>

properties:
  compatible:
    const: st,stm32mp25-usbh

  "#address-cells":
    const: 1

  "#size-cells":
    const: 1

  ranges: true

  st,syscfg:
    $ref: /schemas/types.yaml#/definitions/phandle-array #(arm/stm32/st,stm32-syscon.yaml#)
    description: Phandle to the STM32-MPU System Controller DT node
                 <syscon-handle usbhcr-offset>

  st,vbusen-active-low:
    type: boolean
    description: VBUS-ENABLE signal polarity is active-low

  st,ovrcur-active-low:
    type: boolean
    description: Over-Current signal polarity is active-low

  wakeup-source: true

  interrupts:
    maxItems: 1
    description: interrupt used for wakeup

  feature-domains:
    $ref: /schemas/types.yaml#/definitions/phandle-array
    description: |
      Phandle to the rifsc device to check access right.

# Required child node:

patternProperties:
  "^usb@[0-9a-f]+$":
    oneOf:
      - $ref: generic-ohci.yaml#
      - $ref: generic-ehci.yaml#

required:
  - compatible
  - "#address-cells"
  - "#size-cells"
  - ranges
  - st,syscfg

allOf:
  - if:
      required:
        - wakeup-source
    then:
      anyOf:
        - required: [interrupts]
        - required: [interrupts-extended]

additionalProperties: false

examples:
  - |

    #include <dt-bindings/clock/stm32mp25-clks.h>
    #include <dt-bindings/interrupt-controller/arm-gic.h>
    #include <dt-bindings/reset/stm32mp25-resets.h>


    usbh: usb@482e0000 {
        compatible      = "st,stm32mp25-usbh";
        st,syscfg       = <&syscfg 0x2420>;
        #address-cells  = <1>;
        #size-cells     = <1>;
        ranges = <0x482e0000 0x482e0000 0x2000>;
        st,ovrcur-active-low;
        st,vbusen-active-low;
        wakeup-source;
        interrupts-extended = <&exti1 43 IRQ_TYPE_EDGE_RISING>;

        usbh_ohci: usb@482e0000 {
            compatible = "generic-ohci";
            reg = <0x482e0000 0x1000>;
            clocks = <&rcc CK_BUS_USB2OHCI>;
            resets = <&rcc USB2_R>;
            interrupts = <GIC_SPI 140 IRQ_TYPE_LEVEL_HIGH>;
            phys = <&usb2_phy1>;
            phy-names = "usb";
        };

        usbh_ehci: usb@482f0000 {
            compatible = "generic-ehci";
            reg = <0x482f0000 0x1000>;
            clocks = <&rcc CK_BUS_USB2EHCI>;
            resets = <&rcc USB2_R>;
            interrupts = <GIC_SPI 139 IRQ_TYPE_LEVEL_HIGH>;
            companion = <&usbh_ohci>;
            phys = <&usb2_phy1>;
            phy-names = "usb";
        };
    };
```

## drivers/media/platform/st/stm32/Kconfig
```kconfig
# SPDX-License-Identifier: GPL-2.0-only

# V4L drivers
config VIDEO_STM32_CSI2HOST
	tristate "STM32 Camera Serial Interface (CSI) support"
	depends on VIDEO_DEV && OF
	depends on ARCH_STM32 || COMPILE_TEST
	select MEDIA_CONTROLLER
	select V4L2_FWNODE
	help
	  This module makes the STM32 Camera Serial Interface (CSI)
	  available as a v4l2 device.

	  To compile this driver as a module, choose M here: the module
	  will be called stm32-csi2host.

config VIDEO_STM32_DCMI
	tristate "STM32 Digital Camera Memory Interface (DCMI) support"
	depends on V4L_PLATFORM_DRIVERS
	depends on VIDEO_DEV && OF
	depends on ARCH_STM32 || COMPILE_TEST
	select VIDEOBUF2_DMA_CONTIG
	select MEDIA_CONTROLLER
	select V4L2_FWNODE
	help
	  This module makes the STM32 Digital Camera Memory Interface (DCMI)
	  available as a v4l2 device.

	  To compile this driver as a module, choose M here: the module
	  will be called stm32-dcmi.

config VIDEO_STM32_DCMIPP
	tristate "STM32 Digital Camera Memory Interface Pixel Processor (DCMIPP) support"
	depends on VIDEO_DEV && OF && MEDIA_CONTROLLER
	depends on ARCH_STM32 || COMPILE_TEST
	select VIDEOBUF2_DMA_CONTIG
	select VIDEOBUF2_VMALLOC
	select V4L2_FWNODE
	help
	  This module makes the STM32 Digital Camera Memory Interface
	  Pixel Processor (DCMIPP) available as a v4l2 device.

	  To compile this driver as a module, choose M here: the module
	  will be called stm32-dcmipp.

# Mem2mem drivers
config VIDEO_STM32_DMA2D
	tristate "STM32 Chrom-Art Accelerator (DMA2D)"
	depends on V4L_MEM2MEM_DRIVERS
	depends on VIDEO_DEV
	depends on ARCH_STM32 || COMPILE_TEST
	select VIDEOBUF2_DMA_CONTIG
	select V4L2_MEM2MEM_DEV
	help
	  Enables DMA2D hardware support on stm32.

	  The STM32 DMA2D is a memory-to-memory engine for pixel conversion
	  and specialized DMA dedicated to image manipulation.
```
