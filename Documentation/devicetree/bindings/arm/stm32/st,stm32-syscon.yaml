## Documentation/devicetree/bindings/soc/st/st,stm32mp25-risaf.yaml
```yaml
# SPDX-License-Identifier: (GPL-2.0-only OR BSD-2-Clause)
%YAML 1.2
---
$id: http://devicetree.org/schemas/soc/st/st,stm32mp25-risaf.yaml#
$schema: http://devicetree.org/meta-schemas/core.yaml#

title: STM32 Resource isolation peripheral unit for address space protection
       (full version)

maintainers:
  - Gatien Chevallier <gatien.chevallier@foss.st.com>

description: |
  The RIF (resource isolation framework) is a comprehensive set of hardware
  blocks designed to enforce and manage isolation of STM32 hardware resources,
  like memories and peripherals.
  Through RISAF registers, a trusted domain, or the domain to whom the
  configuration has been delegated, assigns memory regions and subregions to
  one or more security domains (secure, privilege, compartment).
  RISAF managing DRR includes the DDR memory cipher engine (DDRMCE) feature.

properties:
  compatible:
    enum:
      - st,stm32mp25-risaf
      - st,stm32mp25-risaf-enc

  reg:
    maxItems: 1

  clocks:
    maxItems: 1

  st,mem-map:
    $ref: /schemas/types.yaml#/definitions/uint32-array
    minItems: 2
    maxItems: 4
    description:
      Defines the memory address range covered by the RISAF instance.

  memory-region:
    minItems: 1
    maxItems: 16
    description: |
      Phandle to a node describing memory areas to be configured by the RISAF.
      These regions cannot overlap. A zone must be within st,mem-map range.

required:
  - compatible
  - reg
  - clocks
  - st,mem-map

additionalProperties: false

examples:
  - |
        #include <dt-bindings/clock/st,stm32mp25-rcc.h>

        risaf4: risaf@420d0000 {
          compatible = "st,stm32mp25-risaf-enc";
          reg = <0x420d0000 0x1000>;
          clocks = <&rcc CK_BUS_RISAF4>;
          st,mem-map = <0x0 0x80000000 0x1 0x00000000>;
        };
```

## Documentation/devicetree/bindings/soc/st/stm32mp-pm-domain.yaml
```yaml
# SPDX-License-Identifier: (GPL-2.0-only OR BSD-2-Clause)
%YAML 1.2
---
$id: http://devicetree.org/schemas/soc/st/stm32mp-pm-domain.yaml#
$schema: http://devicetree.org/meta-schemas/core.yaml#

title: STM32MP generic power domain

maintainers:
  - Patrick Delaunay <patrick.delaunay@foss.st.com>

allOf:
  - $ref: /schemas/power/power-domain.yaml#

description: |
  Some STM32MP SoCs contain a D1 domain which defined the devices
  assigned to Cortex A35, these device are functionnal only when the cortex the
  A35 cluster is not in low power modes with clock OFF.

  This PM domain node represents the D1 dependency depndency for clock PM
  framework with the parent power domain but without wake-up path support.

properties:
  compatible:
    const: st,stm32mp-pm-domain

  '#power-domain-cells':
    const: 0

  power-domains:
    maxItems: 1

additionalProperties: false

required:
  - compatible
  - '#power-domain-cells'
  - power-domains

examples:
  - |
    power-domain-d1 {
      compatible = "st,stm32mp-pm-domain";
      #power-domain-cells = <0>;
      power-domains = <&CLUSTER_PD>;
    };
```

## Documentation/devicetree/bindings/spi/st,stm32-spi.yaml
```yaml
# SPDX-License-Identifier: (GPL-2.0-only OR BSD-2-Clause)
%YAML 1.2
---
$id: http://devicetree.org/schemas/spi/st,stm32-spi.yaml#
$schema: http://devicetree.org/meta-schemas/core.yaml#

title: STMicroelectronics STM32 SPI Controller bindings

description: |
  The STM32 SPI controller is used to communicate with external devices using
  the Serial Peripheral Interface. It supports full-duplex, half-duplex and
  simplex synchronous serial communication with external devices. It supports
  from 4 to 32-bit data size.

maintainers:
  - Erwan Leray <erwan.leray@foss.st.com>
  - Fabrice Gasnier <fabrice.gasnier@foss.st.com>

allOf:
  - $ref: "spi-controller.yaml#"
  - if:
      properties:
        compatible:
          contains:
            const: st,stm32f4-spi

    then:
      properties:
        st,spi-midi-ns: false
        spi-slave: false
        st,spi-slave-underrun: false

properties:
  "#address-cells": true
  "#size-cells": true

  compatible:
    enum:
      - st,stm32f4-spi
      - st,stm32h7-spi
      - st,stm32mp25-spi

  reg:
    maxItems: 1

  clocks:
    maxItems: 1

  interrupts:
    maxItems: 1

  resets:
    maxItems: 1

  power-domains:
    maxItems: 1

  dmas:
    description: |
      DMA specifiers for tx and rx dma. DMA fifo mode must be used. See
      the STM32 DMA bindings Documentation/devicetree/bindings/dma/st,stm32-dma.yaml.
    items:
      - description: rx DMA channel
      - description: tx DMA channel

  dma-names:
    items:
      - const: rx
      - const: tx

  spi-slave:
    description:
      The SPI controller acts as a slave, instead of a master.

  cs-gpios:
    description:
      In case of spi-slave not defined, cs-gpios behave as defined in
      spi-controller.yaml.
      In case of spi-slave defined, if <0>, indicate that SS should be
      detected via the dedicated HW pin

  st,spi-slave-underrun:
    $ref: /schemas/types.yaml#/definitions/uint32-array
    description:
      First parameter enables and selects slave underrun reaction.
      Refer to "dt-bindings/spi/spi-stm32.h" for the supported values.
      Second parameter is the pattern in case of SPI_SEND_PATTERN mode.

  feature-domains:
    $ref: /schemas/types.yaml#/definitions/phandle-array
    description: |
      Phandle to the rifsc device to check access right.

patternProperties:
  "^[a-zA-Z][a-zA-Z0-9,+\\-._]{0,63}@[0-9a-f]+$":
    type: object
    # SPI slave nodes must be children of the SPI master node and can
    # contain the following properties.
    properties:
      st,spi-midi-ns:
        description: |
          Only available since STM32H7, (Master Inter-Data Idleness) minimum time
          delay in nanoseconds inserted between two consecutive data frames.

required:
  - compatible
  - reg
  - clocks
  - interrupts

unevaluatedProperties: false

examples:
  - |
    #include <dt-bindings/interrupt-controller/arm-gic.h>
    #include <dt-bindings/clock/stm32mp1-clks.h>
    #include <dt-bindings/reset/stm32mp1-resets.h>
    spi@4000b000 {
      #address-cells = <1>;
      #size-cells = <0>;
      compatible = "st,stm32h7-spi";
      reg = <0x4000b000 0x400>;
      interrupts = <GIC_SPI 36 IRQ_TYPE_LEVEL_HIGH>;
      clocks = <&rcc SPI2_K>;
      resets = <&rcc SPI2_R>;
      dmas = <&dmamux1 0 39 0x400 0x05>,
             <&dmamux1 1 40 0x400 0x05>;
      dma-names = "rx", "tx";
      cs-gpios = <&gpioa 11 0>;

    };

...
```
