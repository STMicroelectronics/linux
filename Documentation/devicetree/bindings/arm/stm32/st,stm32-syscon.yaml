## Documentation/devicetree/bindings/arm/stm32/st,stm32-syscon.yaml
```yaml
# SPDX-License-Identifier: (GPL-2.0 OR BSD-2-Clause)
%YAML 1.2
---
$id: "http://devicetree.org/schemas/arm/stm32/st,stm32-syscon.yaml#"
$schema: "http://devicetree.org/meta-schemas/core.yaml#"

title: STMicroelectronics STM32 Platforms System Controller

maintainers:
  - Alexandre Torgue <alexandre.torgue@foss.st.com>
  - Christophe Roullier <christophe.roullier@foss.st.com>

properties:
  compatible:
    oneOf:
      - items:
          - enum:
              - st,stm32mp157-syscfg
              - st,stm32mp25-syscfg
              - st,stm32mp151-pwr-mcu
              - st,stm32-syscfg
              - st,stm32-power-config
              - st,stm32-tamp
              - st,stm32mp25-tamp
              - st,stm32mp25-a35ss-syscfg
          - const: syscon
      - items:
          - const: st,stm32-tamp
          - const: syscon
          - const: simple-mfd

  reg:
    maxItems: 1

  clocks:
    maxItems: 1

  '#address-cells':
    const: 1

  '#size-cells':
    const: 1

  ranges: true

  reboot-mode:
    type: object
    $ref: /schemas/power/reset/reboot-mode.yaml#

patternProperties:
  "^nvram@[0-9a-f]+$":
    type: object
    $ref: /schemas/nvmem/st,stm32-tamp-nvram.yaml#

required:
  - compatible
  - reg

allOf:
  - if:
      properties:
        compatible:
          contains:
            enum:
              - st,stm32mp157-syscfg
    then:
      required:
        - clocks
  - if:
      properties:
        compatible:
          contains:
            enum:
              - st,stm32-tamp
    then:
      required:
        - '#address-cells'
        - '#size-cells'
        - ranges

additionalProperties: false

examples:
  - |
    #include <dt-bindings/clock/stm32mp1-clks.h>
    syscfg: syscon@50020000 {
        compatible = "st,stm32mp157-syscfg", "syscon";
        reg = <0x50020000 0x400>;
        clocks = <&rcc SYSCFG>;
    };

...
```

## Documentation/devicetree/bindings/bus/st,sys-bus.yaml
```yaml
# SPDX-License-Identifier: GPL-2.0-only OR BSD-2-Clause
%YAML 1.2
---
$id: http://devicetree.org/schemas/bus/stm32,sys-bus.yaml
$schema: http://devicetree.org/meta-schemas/core.yaml#

title:  STM32 System Bus

description: |
  The STM32 System Bus is an internal bus to which some internal peripherals
  are connected. STM32 System Bus integrates a firewall controlling access to each
  device. This bus prevents non-accessible devices to be probed.

  To see which peripherals are securable, please check the SoC reference manual.

maintainers:
  - Gatien Chevallier <gatien.chevallier@foss.st.com>

properties:
  compatible:
    enum:
      - st,stm32mp13-sys-bus
      - st,stm32mp15-sys-bus
      - st,stm32mp25-sys-bus

  reg:
    maxItems: 1

  "#address-cells":
    description: |
      The first cell is the bank number (chip select).
      The second cell is the address offset within the bank.
    const: 2

  "#size-cells":
    const: 1

  '#feature-domain-cells':
    $ref: /schemas/types.yaml#/definitions/uint32
    description:
      Number of cells in a domain controller specifier.
      Set const to 2 here for nodes providing the peripheral
      id for the firewall check.
    const: 1

  ranges: true

  feature-domain-controller: true

patternProperties:
  "^.*@[1-5],[1-9a-f][0-9a-f]+$":
    description: Devices attached to system bus
    type: object

required:
  - compatible
  - reg
  - "#address-cells"
  - "#size-cells"
  - feature-domain-controller
  - '#feature-domain-cells'
  - ranges

additionalProperties: false

examples:
  - |
    // In this example,
    // - the hash1 device refers to etzpc as his domain controller.
    // - same goes for rng1.
    // Access rights are verified before creating devices.

    #include <dt-bindings/interrupt-controller/arm-gic.h>
    #include <dt-bindings/clock/stm32mp1-clks.h>
    #include <dt-bindings/reset/stm32mp1-resets.h>
    #include <dt-bindings/bus/stm32mp15_sys_bus.h>

    etzpc: etzpc@0x5C007000 {
        compatible = "st,stm32mp15-sys-bus";
        reg = <0x5c007000 0x400>;
        #address-cells = <1>;
        #size-cells = <1>;
        ranges;
        feature-domain-controller;
        #feature-domain-cells = <2>;

        hash1: hash@54002000 {
          compatible = "st,stm32f756-hash";
          reg = <0x54002000 0x400>;
          interrupts = <GIC_SPI 80 IRQ_TYPE_LEVEL_HIGH>;
          clocks = <&scmi_clk CK_SCMI_HASH1>;
          resets = <&scmi_reset RST_SCMI_HASH1>;
          dmas = <&mdma1 31 0x2 0x1000A02 0x0 0x0 0x0>;
          dma-names = "in";
          dma-maxburst = <2>;
          feature-domains = <&etzpc STM32MP1_ETZPC_HASH1_ID>;
          status = "disabled";
        };

        rng1: rng@54003000 {
          compatible = "st,stm32-rng";
          reg = <0x54003000 0x400>;
          clocks = <&scmi_clk CK_SCMI_RNG1>;
          resets = <&scmi_reset RST_SCMI_RNG1>;
          feature-domains = <&etzpc STM32MP1_ETZPC_RNG1_ID>;
          status = "disabled";
        };
    };
```

## Documentation/devicetree/bindings/clock/st,stm32mp25-rcc.yaml
```yaml
# SPDX-License-Identifier: (GPL-2.0-only OR BSD-2-Clause)
%YAML 1.2
---
$id: http://devicetree.org/schemas/clock/st,stm32mp25-rcc.yaml#
$schema: http://devicetree.org/meta-schemas/core.yaml#

title: STM32MP25 Reset Clock Controller

maintainers:
  - Gabriel Fernandez <gabriel.fernandez@foss.st.com>

description: |
  The RCC hardware block is both a reset and a clock controller.
  RCC makes also power management (resume/supend).

  Specifying clocks
  =================

  All available clocks are defined as preprocessor macros in
  dt-bindings/clock/stm32mp25-clks.h header and can be used in device
  tree sources.
  This file implements defines like:
      #define CK_BUS_SDMMC1 245
      #define CK_KER_SDMMC1 313

  Specifying softreset control of devices
  =======================================

  Device nodes should specify the reset channel required in their "resets"
  property, containing a phandle to the reset device node and an index
  specifying which channel to use.
  The index is the bit number within the RCC registers bank, starting from RCC
  base address.
  It is calculated as: index = register_offset / 4 * 32 + bit_offset.
  Where bit_offset is the bit offset within the register.

  For example on STM32MP25, for LTDC reset:
     ltdc = RCC_LTDCCFGR offset / 4 * 32 + LTDC_bit_offset
          = 0x840 / 4 * 32 + 0 = 16896

  See also::
    include/dt-bindings/clock/stm32mp25-clks.h
    include/dt-bindings/reset/stm32mp25-resets.h

properties:
  compatible:
    enum:
      - st,stm32mp25-rcc

  reg:
    maxItems: 1

  '#clock-cells':
    const: 1

  '#reset-cells':
    const: 1

  clocks:
    items:
      - description: CK_SCMI_HSE High Speed External oscillator (8 to 48 MHz)
      - description: CK_SCMI_HSI High Speed Internal oscillator (~ 64 MHz)
      - description: CK_SCMI_MSI Low Power Internal oscillator (~ 4 MHz or ~ 16 MHz)
      - description: CK_SCMI_LSE Low Speed External oscillator (32 KHz)
      - description: CK_SCMI_LSI Low Speed Internal oscillator (~ 32 KHz)

  clock-names:
    items:
      - const: hse
      - const: hsi
      - const: msi
      - const: lse
      - const: lsi

  feature-domains:
    $ref: /schemas/types.yaml#/definitions/phandle-array
    description: |
      Phandle to the rifsc device to check access right.

required:
  - compatible
  - reg
  - '#clock-cells'
  - '#reset-cells'
  - clocks
  - clock-names

additionalProperties: false

examples:
  - |
    #include <dt-bindings/clock/stm32mp25-clks.h>

    rcc: clock-controller@44200000 {
        compatible = "st,stm32mp25-rcc";
        reg = <0x44200000 0x10000>;
        #clock-cells = <1>;
        #reset-cells = <1>;
        clock-names = "hse", "hsi", "msi", "lse", "lsi";
        clocks = <&scmi_clk CK_SCMI_HSE>,
                 <&scmi_clk CK_SCMI_HSI>,
                 <&scmi_clk CK_SCMI_MSI>,
                 <&scmi_clk CK_SCMI_LSE>,
                 <&scmi_clk CK_SCMI_LSI>;
        feature-domains = <&rifsc 156>;
    };
...
```

## Documentation/devicetree/bindings/display/st,stm32-lvds.yaml
```yaml
# SPDX-License-Identifier: (GPL-2.0-only OR BSD-2-Clause)
%YAML 1.2
---
$id: http://devicetree.org/schemas/display/st,stm32-lvds.yaml#
$schema: http://devicetree.org/meta-schemas/core.yaml#

title: STMicroelectronics STM32 LVDS Display Interface Transmitter

maintainers:
  - Raphael Gallais-Pou <raphael.gallais-pou@foss.st.com>
  - Yannick Fertre <yannick.fertre@foss.st.com>

description: |
  The STMicroelectronics STM32 LVDS Display Interface Transmitter handles the
  LVDS protocol: it maps the pixels received from the upstream Pixel-DMA (LTDC)
  onto the LVDS PHY.

properties:
  "#clock-cells":
    const: 0

  compatible:
    const: st,stm32mp25-lvds

  reg:
    maxItems: 1

  clocks:
    items:
      - description: APB peripheral clock
      - description: Reference clock for the internal PLL

  clock-names:
    items:
      - const: pclk
      - const: ref

  resets:
    maxItems: 1

  feature-domains:
    minItems: 1
    maxItems: 2

  power-domains:
    maxItems: 1

  ports:
    $ref: /schemas/graph.yaml#/properties/ports

    properties:
      port@0:
        $ref: /schemas/graph.yaml#/properties/port
        description: |
          LVDS input port node, connected to the LTDC RGB output port.

      port@1:
        $ref: /schemas/graph.yaml#/properties/port
        description: |
          LVDS output port node, connected to a panel or bridge input port.

required:
  - "#clock-cells"
  - compatible
  - reg
  - clocks
  - clock-names
  - resets
  - ports

unevaluatedProperties: false

examples:
  - |
    #include <dt-bindings/bus/stm32mp25_sys_bus.h>
    #include <dt-bindings/clock/stm32mp25-clks.h>
    #include <dt-bindings/reset/stm32mp25-resets.h>

    lvds: lvds@48060000 {
        #clock-cells = <0>;
        compatible = "st,stm32-lvds";
        reg = <0x48060000 0x2000>;
        clocks = <&rcc CK_BUS_LVDS>, <&rcc CK_KER_LVDSPHY>;
        clock-names = "pclk", "ref";
        resets = <&rcc LVDS_R>;
        feature-domains = <&rifsc STM32MP25_RIFSC_LVDS_ID>;
        power-domains = <&CLUSTER_PD>;

        ports {
            #address-cells = <1>;
            #size-cells = <0>;

            port@0 {
                reg = <0>;
                lvds_in: endpoint {
                   remote-endpoint = <&ltdc_ep1_out>;
                };
            };

            port@1 {
                reg = <1>;
                lvds_out0: endpoint {
                   remote-endpoint = <&lvds_panel_in>;
                };
            };
        };
    };

...
```
