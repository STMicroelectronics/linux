## Documentation/devicetree/bindings/phy/st,stm32-usb2phy.yaml
```yaml
# SPDX-License-Identifier: (GPL-2.0-only OR BSD-2-Clause)
%YAML 1.2
---
$id: "http://devicetree.org/schemas/phy/st,stm32-usb2phy.yaml#"
$schema: "http://devicetree.org/meta-schemas/core.yaml#"

title: STMicroelectronics STM32 MPU High-Speed USB PHY

description:
  USB2 PHY block inside STM32 is used for supporting the HS/FS/LS operation
  for USB controller. For stm32mp25, it is used by USBH ctrl in HS/FS/LS mode
  and by DWC3 ctrl in USB2 LS/FS/HS modes (when host) or USB2 FS/HS modes (when device)

maintainers:
  - Fabrice Gasnier <fabrice.gasnier@foss.st.com>
  - Pankaj Dev <pankaj.dev@st.com>

properties:
  compatible:
    const: st,stm32mp25-usb2phy

  "#phy-cells":
    const: 0

  clocks:
    items:
      description: PHY ref clock

  resets:
    items:
      description: PHY core reset

  vdd33-supply:
    description: phandle to regulator providing 3V3 power supply to the USB2 HS PHY

  vdda18-supply:
    description: phandle to regulator providing 1V8 power supply to the USB2 HS PHY

  st,syscfg:
    $ref: /schemas/types.yaml#/definitions/phandle-array #(arm/stm32/st,stm32-syscon.yaml#)
    description: Phandle to the STM32-MPU System Controller DT node
                 <syscon-handle cr-offset>

  st,pll-ipath-tune:
    $ref: /schemas/types.yaml#/definitions/uint8
    description: PLL Integral Path Tune
                 0->0.5x 1->1.0x 2->1.5x 3->2.0x
    minimum: 0
    maximum: 3
    default: 0

  st,pll-ppath-tune:
    $ref: /schemas/types.yaml#/definitions/uint8
    description: PLL Proportional Path Tune
                 0->1.0x 1->1.50x 2->2.0x ... 15->5.5x
    minimum: 0
    maximum: 15
    default: 12

  st,comp-dis-tune:
    $ref: /schemas/types.yaml#/definitions/uint8
    description: Disconnect Threshold Adjustment
                 0->-9% 1->-6% 2->-4% 3->0% 4->3% 5->7% 6->10% 7->12%
    minimum: 0
    maximum: 7
    default: 3

  st,sqrx-tune:
    $ref: /schemas/types.yaml#/definitions/uint8
    description: Squelch Threshold Adjustment
                 0->15% 1->10% 2->5% 3->0% 4->-5% 5->-10% 6->-15% 7->-20%
    minimum: 0
    maximum: 7
    default: 3

  st,vdatref-tune:
    $ref: /schemas/types.yaml#/definitions/uint8
    description: Data Detect Voltage Adjustment
                 0->10% 1->0% 2->-10% 3->-20%
    minimum: 0
    maximum: 3
    default: 1

  st,otg-tune:
    $ref: /schemas/types.yaml#/definitions/uint8
    description: VBUS Valid Threshold Adjustment
                 0->-9% 1->-6% 2->-3% 3->0% 4->3% 5->6% 6->9% 7->12%
    minimum: 0
    maximum: 7
    default: 3

  st,txhsxv-tune:
    $ref: /schemas/types.yaml#/definitions/uint8
    description: Transmitter High Speed Crossover Adjustment
                 0->Rsvd 1->-15mV 2->15mV 3->0mV
    minimum: 1
    maximum: 3
    default: 3

  st,txfsls-tune:
    $ref: /schemas/types.yaml#/definitions/uint8
    description: FS/LS Source Impedance Adjustment
                 0->14% 1->6.5% 2->Rsvd 3->0% 7->-5/6% 15->-10.7% other-values->Rsvd
    enum: [ 0, 1, 3, 7, 15 ]
    default: 3

  st,txvref-tune:
    $ref: /schemas/types.yaml#/definitions/uint8
    description: HS DC Voltage Level Adjustment
                 0->-6% 1->-4% 2->-2% 3->0% 4->2% 5->4% 6->6% ... 15->24%
    minimum: 0
    maximum: 15
    default: 3

  st,txrise-tune:
    $ref: /schemas/types.yaml#/definitions/uint8
    description: HS Transmitter Rise/Fall Time Adjustment
                 0->+5.4% 1->nominal 2->-7.2% 3->-8.1%
    minimum: 0
    maximum: 3
    default: 1

  st,txres-tune:
    $ref: /schemas/types.yaml#/definitions/uint8
    description: USB Source Impedance Adjustment
                 0->+1.3Ohm 1->0Ohm 2->-3.6Ohm 3->-5.6Ohm
    minimum: 0
    maximum: 3
    default: 1

  st,txpreempamp-tune:
    $ref: /schemas/types.yaml#/definitions/uint8
    description: HS Transmitter Pre Emphasis Current Control
                 0->Disabled 1->1x 2->2x 3->3x
    minimum: 0
    maximum: 3
    default: 0

  st,txpreemppulse-tune:
    $ref: /schemas/types.yaml#/definitions/uint8
    description: HS Transmitter Pre Emphasis Duration Control
                 0->2x 1->1x
    minimum: 0
    maximum: 1
    default: 0

  "#clock-cells":
    description: number of clock cells for ck_usb2phyXXXX_48m consumer
    const: 0

required:
  - compatible
  - "#phy-cells"
  - clocks
  - resets
  - vdd33-supply
  - st,syscfg
  - "#clock-cells"

additionalProperties: false

examples:
  - |
    #include <dt-bindings/clock/stm32mp25-clks.h>
    #include <dt-bindings/interrupt-controller/arm-gic.h>
    #include <dt-bindings/reset/stm32mp25-resets.h>

    usb2_phy2: usb-phy {
        compatible      = "st,stm32mp25-usb2phy";
        #phy-cells      = <0>;
        #clock-cells    = <0>;
        st,syscfg       = <&syscfg 0x2800>;
        clocks          = <&rcc CK_KER_USB2PHY2>;
        resets          = <&rcc USB2PHY2_R>;
        vdd33-supply    = <&vdd33usb>;

        st,pll-ipath-tune = /bits/ 8 <0>;
        st,pll-ppath-tune = /bits/ 8 <0>;
        st,comp-dis-tune = /bits/ 8 <0>;
        st,sqrx-tune = /bits/ 8 <0>;
        st,vdatref-tune = /bits/ 8 <0>;
        st,otg-tune = /bits/ 8 <0>;
        st,txhsxv-tune = /bits/ 8 <1>;
        st,txfsls-tune = /bits/ 8 <0>;
        st,txvref-tune = /bits/ 8 <0>;
        st,txrise-tune = /bits/ 8 <1>;
        st,txres-tune = /bits/ 8 <0>;
        st,txpreempamp-tune = /bits/ 8 <0>;
        st,txpreemppulse-tune = /bits/ 8 <0>;
    };
```

## Documentation/devicetree/bindings/pinctrl/st,stm32-pinctrl-hdp.yaml
```yaml
# SPDX-License-Identifier: (GPL-2.0-only OR BSD-2-Clause)
# Copyright (C) STMicroelectronics 2024.
%YAML 1.2
---
$id: http://devicetree.org/schemas/pinctrl/st,stm32-pinctrl-hdp.yaml#
$schema: http://devicetree.org/meta-schemas/core.yaml#

title: STM32 Hardware Debug Port Mux/Config

maintainers:
  - Clément LE GOFFIC <clement.legoffic@foss.st.com>

description: |
  STMicroelectronics's STM32 MPUs integrate a Hardware Debug Port (HDP).
  It permits to output internal signals on SoC's GPIO.

properties:
  compatible:
    const: st,stm32mp-hdp

  reg:
    maxItems: 1

  clocks:
    maxItems: 1

patternProperties:
  '-pins$':
    type: object
    $ref: pinmux-node.yaml#

    properties:
      function:
        enum: [ "0", "1", "2", "3", "4", "5", "6", "7",
                "8", "9", "10", "11", "12", "13", "14",
                "15" ]

      pins:
        enum: [ hdp0, hdp1, hdp2, hdp3, hdp4, hdp5, hdp6, hdp7 ]

    required:
      - function
      - pins

    additionalProperties: false

allOf:
  - $ref: "pinctrl.yaml#"

required:
  - compatible
  - reg
  - clocks

additionalProperties: false

examples:
  - |
    #include <dt-bindings/clock/stm32mp1-clks.h>
    #include <dt-bindings/pinctrl/stm32mp15-hdp.h>
    //Example 1
    hdp: pinctrl@54090000 {
      compatible = "st,stm32mp-hdp";
      reg = <0x54090000 0x400>;
      clocks = <&rcc HDP>;
      pinctrl-names = "default";
      pinctrl-0 = <&hdp2>;
      hdp2: hdp2-pins {
        function = HDP2_GPOVAL_2;
        pins = "hdp2";
      };
    };

  - |
    #include <dt-bindings/clock/stm32mp1-clks.h>
    #include <dt-bindings/pinctrl/stm32mp15-hdp.h>
    //Example 2
    hdp: pinctrl@54090000 {
      compatible = "st,stm32mp-hdp";
      reg = <0x54090000 0x400>;
      clocks = <&rcc HDP>;
      hdp2: hdp2-pins {
        pins = "hdp2";
        function = HDP2_GPOVAL_2;
      };
    };

    foo {
      pinctrl-names = "default";
      pinctrl-0 = <&hdp2>;
    };
```

## Documentation/devicetree/bindings/remoteproc/st,stm32-rproc.yaml
```yaml
# SPDX-License-Identifier: (GPL-2.0 OR BSD-2-Clause)
%YAML 1.2
---
$id: "http://devicetree.org/schemas/remoteproc/st,stm32-rproc.yaml#"
$schema: "http://devicetree.org/meta-schemas/core.yaml#"

title: STMicroelectronics STM32 remote processor controller bindings

description:
  This document defines the binding for the remoteproc component that loads and
  boots firmwares on the ST32MP family chipset.

maintainers:
  - Fabien Dessenne <fabien.dessenne@foss.st.com>
  - Arnaud Pouliquen <arnaud.pouliquen@foss.st.com>

properties:
  compatible:
    enum:
      - st,stm32mp1-m4
      - st,stm32mp1-m4-tee
      - st,stm32mp2-m33
      - st,stm32mp2-m33-tee
    description:
      Use "st,stm32mp1-m4" for the stm32mp15 Cortex-M4 coprocessor management by Linux
      Use "st,stm32mp1-m4-tee" for the stm32mp15 Cortex-M4 coprocessor management by OPTEE
      Use "st,stm32mp2-m33" for the stm32mp2 Cortex-M33 coprocessor management by Linux
      Use "st,stm32mp2-m33-tee" for the stm32mp2 Cortex-M33 coprocessor management by OPTEE
  reg:
    description:
      Address ranges of the RETRAM and MCU SRAM memories used by the remote
      processor.
    maxItems: 3

  resets:
    minItems: 1
    maxItems: 2

  reset-names:
    items:
      - const: mcu_rst
      - const: hold_boot
    minItems: 1

  st,syscfg-holdboot:
    description: remote processor reset hold boot
    $ref: "/schemas/types.yaml#/definitions/phandle-array"
    items:
      - items:
          - description: Phandle of syscon block
          - description: The offset of the hold boot setting register
          - description: The field mask of the hold boot

  interrupts:
    description: Should contain the WWDG1 watchdog reset interrupt
    maxItems: 1

  wakeup-source: true

  mboxes:
    description:
      This property is required only if the rpmsg/virtio functionality is used.
    items:
      - description: |
          A channel (a) used to communicate through virtqueues with the
          remote proc.
          Bi-directional channel:
            - from local to remote = send message
            - from remote to local = send message ack
      - description: |
          A channel (b) working the opposite direction of channel (a)
      - description: |
          A channel (c) used by the local proc to notify the remote proc that it
          is about to be shut down.
          Unidirectional channel:
            - from local to remote, where ACK from the remote means that it is
              ready for shutdown
      - description: |
          A channel (d) used by the local proc to notify the remote proc that it
          has to stop interprocessor communnication.
          Unidirectional channel:
            - from local to remote, where ACK from the remote means that communnication
              as been stopped on the remote side.
    minItems: 1

  mbox-names:
    items:
      - const: vq0
      - const: vq1
      - const: shutdown
      - const: detach
    minItems: 1

  memory-region:
    description:
      List of phandles to the reserved memory regions associated with the
      remoteproc device. This is variable and describes the memories shared with
      the remote processor (e.g. remoteproc firmware and carveouts, rpmsg
      vrings, ...).
      (see ../reserved-memory/reserved-memory.txt)

  st,syscfg-pdds:
    $ref: "/schemas/types.yaml#/definitions/phandle-array"
    description: |
      Reference to the system configuration which holds the remote
    items:
      - items:
          - description: Phandle of syscon block
          - description: The offset of the power setting register
          - description: The field mask of the PDDS selection

  st,syscfg-nsvtor:
    $ref: "/schemas/types.yaml#/definitions/phandle-array"
    description: |
      Reference to the system configuration register which stores the remote processor
      non-secure vector table pointer.
      address, used to boot it.
    maxItems: 1

  st,syscfg-cm-state:
    $ref: "/schemas/types.yaml#/definitions/phandle-array"
    description: |
      Reference to the register which exposes the Cortex-M state.
    items:
      - items:
          - description: Phandle of syscon block with the tamp register
          - description: The offset of the tamp register
          - description: The field mask of the Cortex-M4 state

  st,syscfg-rsc-tbl:
    $ref: "/schemas/types.yaml#/definitions/phandle-array"
    description: |
      Reference to the tamp register which references the Cortex-M4
      resource table address.
    items:
      - items:
          - description: Phandle of syscon block with the tamp register
          - description: The offset of the tamp register
          - description: The field mask of the Cortex-M4 resource table address

  nvmem-cells:
    maxItems: 2
    description: |
      Specify the resource table address and size for firmware started by
      the boot loader.

  nvmem-cell-names:
    items:
      - const: rsc-tbl-addr
      - const: rsc-tbl-size

  st,auto-boot:
    $ref: /schemas/types.yaml#/definitions/flag
    description:
      If defined, when remoteproc is probed, it loads the default firmware and
      starts the remote processor.

required:
  - compatible
  - reg
  - resets

allOf:
  - if:
      properties:
        reset-names:
          not:
            contains:
              const: hold_boot
    then:
      required:
        - st,syscfg-holdboot
    else:
      properties:
        st,syscfg-holdboot: false
      properties:
        compatible:
          enum:
            - st,stm32mp1-m4-tee
    then:
      required:
        - memory-region


additionalProperties: false

examples:
#--------------------
# Without SCMI server
#--------------------
  - |
    #include <dt-bindings/reset/stm32mp1-resets.h>
    m4_rproc: m4@10000000 {
      compatible = "st,stm32mp1-m4";
      reg = <0x10000000 0x40000>,
            <0x30000000 0x40000>,
            <0x38000000 0x10000>;
      memory-region = <&retram>, <&mcuram>, <&mcuram2>, <&vdev0vring0>,
                      <&m_ipc_shm>, <&vdev0vring1>, <&vdev0buffer>;
      resets = <&scmi_reset RST_SCMI_MCU>;
      reset-names = "mcu_rst";
      /* Hold boot managed using system config*/
      st,syscfg-holdboot = <&rcc 0x10C 0x1>;
      st,syscfg-rsc-tbl = <&tamp 0x144 0xFFFFFFFF>;
      st,syscfg-cm-state = <&tamp 0x148 0xFFFFFFFF>;
    };

#--------------------
# With SCMI server
#--------------------
  - |
    #include <dt-bindings/reset/stm32mp1-resets.h>
    m4_rproc_w_scmi: m4@10000000 {
      compatible = "st,stm32mp1-m4";
      reg = <0x10000000 0x40000>,
            <0x30000000 0x40000>,
            <0x38000000 0x10000>;
      resets = <&scmi_reset RST_SCMI_MCU>,
               <&scmi_reset RST_SCMI_MCU_HOLD_BOOT>;
      reset-names = "mcu_rst", "hold_boot";
      st,syscfg-rsc-tbl = <&tamp 0x144 0xFFFFFFFF>;
      st,syscfg-cm-state = <&tamp 0x148 0xFFFFFFFF>;
    };
...
```
