## Documentation/devicetree/bindings/net/stm32-ttt.yaml
```yaml
# SPDX-License-Identifier: (GPL-2.0 OR BSD-2-Clause)
# Copyright 2019 BayLibre, SAS
%YAML 1.2
---
$id: "http://devicetree.org/schemas/net/stm32-ttt.yaml#"
$schema: "http://devicetree.org/meta-schemas/core.yaml#"

title: STMicroelectronics STM32 TSN switch glue layer controller

maintainers:
  - Alexandre Torgue <alexandre.torgue@foss.st.com>

description:
  This file documents platform glue layer for the TSN switch.

properties:
  compatible:
    contains:
      enum:
        - st,stm32-deip

patternProperties:
  "^deip-sw@[0-9a-f]+$":
    type: object
    properties:
      compatible:
        enum:
          - ttt,deip-sw
    required:
      - compatible

  "^acm@[0-9a-f]+$":
    type: object
    properties:
      compatible:
        enum:
          - ttt,acm-4.0
    required:
      - compatible

required:
  - compatible

additionalProperties: true

examples:
  - |
    #include <dt-bindings/interrupt-controller/arm-gic.h>
    #include <dt-bindings/clock/stm32mp25-clks.h>
    switch0: ttt-sw@4c000000 {
        #address-cells  = <1>;
        #size-cells     = <1>;
        compatible = "st,stm32-deip";
        clock-names = "ethsw-bus-clk", "ethsw-clk",
                      "ethswacmcfg-bus-clk", "ethswacmmsg-bus-clk";
        clocks = <&rcc CK_BUS_ETHSW>,
                 <&rcc CK_KER_ETHSW>,
                 <&rcc CK_BUS_ETHSWACMCFG>,
                 <&rcc CK_BUS_ETHSWACMMSG>;
        st,syscon = <&syscfg 0x3800>;
        ranges = <0x4b000000 0x4b000000 0xc0000>,
                 <0x4c000000 0x4c000000 0x2000000>;
        status = "disabled";

        deip_sw0: deip-sw@4c000000 {
                compatible =  "ttt,deip-sw";
                reg = <0x4c000000 0x2000000>;
                interrupts = <GIC_SPI 250 IRQ_TYPE_LEVEL_HIGH>;
        };

        acm@4b000000 {
                compatible = "ttt,acm-4.0";
                reg = <0x4b000000 0x00400>,
                      <0x4b010000 0x10000>,
                      <0x4b030000 0x10000>,
                      <0x4b050000 0x10000>,
                      <0x4b060000 0x20000>,
                      <0x4b080000 0x40000>;
                reg-names = "CommonRegister",
                            "Bypass1",
                            "Bypass0",
                            "Redundancy",
                            "Scheduler",
                            "Messagebuffer";
                buffers = <32>;
                ptp_worker = <&deip_sw0>;
        };
    };

...
```

## Documentation/devicetree/bindings/pci/st,stm32-pcie-ep.yaml
```yaml
# SPDX-License-Identifier: (GPL-2.0 OR BSD-2-Clause)
%YAML 1.2
---
$id: http://devicetree.org/schemas/pci/st,stm32-pcie-ep.yaml#
$schema: http://devicetree.org/meta-schemas/core.yaml#

title: PCIe EP controller on STM32MP25 SoC

maintainers:
  - Christian Bruel <christian.bruel@foss.st.com>

description: |
  PCIe EP controller based on the Synopsys DesignWare PCIe core.

allOf:
  - $ref: /schemas/pci/snps,dw-pcie-ep.yaml#

properties:
  compatible:
    const: st,stm32mp25-pcie-ep

  reg:
    items:
      - description: Data Bus Interface (DBI) registers.
      - description: PCIe configuration registers.

  reg-names:
    items:
      - const: dbi
      - const: addr_space

  st,syscfg:
    $ref: /schemas/types.yaml#/definitions/phandle-array
    description: Phandle to the SYSCON entry required for configuring PCIe mode.

  clocks:
    maxItems: 1
    description: PCIe system clock

  clock-names:
    const: core

  resets:
    maxItems: 1

  reset-names:
    const: pcie

  phys:
    maxItems: 1

  phy-names:
    const: pcie-phy

  reset-gpios:
    description: GPIO controlled connection to PERST# signal
    maxItems: 1

  power-domains:
    maxItems: 1

  feature-domains:
    maxItems: 1

required:
  - st,syscfg
  - resets
  - reset-names
  - clocks
  - clock-names
  - phys
  - phy-names
  - reset-gpios

unevaluatedProperties: false

examples:
  - |
    #include <dt-bindings/phy/phy.h>
    #include <dt-bindings/clock/stm32mp25-clks.h>
    #include <dt-bindings/gpio/gpio.h>
    #include <dt-bindings/reset/stm32mp25-resets.h>

    pcie_ep: pcie-ep@48400000 {
             compatible = "st,stm32mp25-pcie-ep";
             num-lanes = <1>;
             reg = <0x48400000 0x400000>,
                   <0x10000000 0x8000000>;
             reg-names = "dbi", "addr_space";
             st,syscfg = <&syscfg>;
             clocks = <&rcc CK_BUS_PCIE>;
             clock-names = "core";
             phys = <&combophy PHY_TYPE_PCIE>;
             phy-names = "pcie-phy";
             resets = <&rcc PCIE_R>;
             reset-names = "pcie";
             pinctrl-names = "default", "init";
             pinctrl-0 = <&pcie_pins_a>;
             pinctrl-1 = <&pcie_init_pins_a>;
             reset-gpios = <&gpioj 8 GPIO_ACTIVE_LOW>;
    };
```

## Documentation/devicetree/bindings/pci/st,stm32-pcie-host.yaml
```yaml
# SPDX-License-Identifier: (GPL-2.0 OR BSD-2-Clause)
%YAML 1.2
---
$id: http://devicetree.org/schemas/pci/st,stm32-pcie-host.yaml#
$schema: http://devicetree.org/meta-schemas/core.yaml#

title: PCIe RC controller on STM32MP25 SoC

maintainers:
  - Christian Bruel <christian.bruel@foss.st.com>

description: |
  PCIe RC controller based on the Synopsys DesignWare PCIe core.

allOf:
  - $ref: /schemas/pci/snps,dw-pcie.yaml#

properties:
  compatible:
    const: st,stm32mp25-pcie-rc

  reg:
    items:
      - description: Data Bus Interface (DBI) registers.
      - description: PCIe configuration registers.

  reg-names:
    items:
      - const: dbi
      - const: config

  st,syscfg:
    $ref: /schemas/types.yaml#/definitions/phandle-array
    description: Phandle to the SYSCON entry required for configuring PCIe mode.

  resets:
    maxItems: 1

  reset-names:
    const: pcie

  clocks:
    maxItems: 1
    description: PCIe system clock

  clock-names:
    const: core

  interrupts:
    description: AER and PME interrupts
    minItems: 1
    maxItems: 2

  interrupt-names:
    items:
      - const: aer_msi
      - const: pme_msi

  phys:
    maxItems: 1

  phy-names:
    const: pcie-phy

  num-lanes:
    const: 1

  max-link-speed:
    enum: [1, 2]
    default: 2

  max-payload-size:
    description: Maximum TLP Payload size to use in device control
      register.
    $ref: /schemas/types.yaml#/definitions/uint32
    enum: [128, 256]
    default: 128

  msi-parent:
    maxItems: 1

  reset-gpios:
    description: GPIO controlled connection to PERST# signal
    maxItems: 1

  power-domains:
    maxItems: 1

  feature-domains:
    maxItems: 1

  wake-gpios:
    description: GPIO controlled connection to WAKE# input signal
    maxItems: 1

  wakeup-source: true

if:
  required:
     - wakeup-source
then:
  required:
     - wake-gpios

  st,limit_mrrs:
    type: boolean
    description: If present limit downstream MRRS to 256B

required:
  - st,syscfg
  - interrupt-map
  - interrupt-map-mask
  - ranges
  - resets
  - reset-names
  - clocks
  - clock-names
  - phys
  - phy-names

unevaluatedProperties: false

examples:
  - |
    #include <dt-bindings/gpio/gpio.h>
    #include <dt-bindings/phy/phy.h>
    #include <dt-bindings/clock/stm32mp25-clks.h>
    #include <dt-bindings/interrupt-controller/arm-gic.h>
    #include <dt-bindings/reset/stm32mp25-resets.h>

    pcie_rc: pcie@48400000 {
             compatible = "st,stm32mp25-pcie-rc";
             device_type = "pci";
             num-lanes = <1>;
             reg = <0x48400000 0x400000>,
                   <0x10000000 0x10000>;
             reg-names = "dbi", "config";
             st,syscfg = <&syscfg>;
             #interrupt-cells = <1>;
             interrupt-map-mask = <0 0 0 7>;
             interrupt-map = <0 0 0 1 &intc 0 0 GIC_SPI 264 IRQ_TYPE_LEVEL_HIGH>,
                             <0 0 0 2 &intc 0 0 GIC_SPI 265 IRQ_TYPE_LEVEL_HIGH>,
                             <0 0 0 3 &intc 0 0 GIC_SPI 266 IRQ_TYPE_LEVEL_HIGH>,
                             <0 0 0 4 &intc 0 0 GIC_SPI 267 IRQ_TYPE_LEVEL_HIGH>;
             interrupts = <GIC_SPI 232 IRQ_TYPE_LEVEL_HIGH>,
                          <GIC_SPI 238 IRQ_TYPE_LEVEL_HIGH>;
             interrupt-names = "aer_msi", "pme_msi";
             #address-cells = <3>;
             #size-cells = <2>;
             ranges = <0x01000000 0 0x10010000 0x10010000 0 0x10000>,
                      <0x02000000 0 0x10020000 0x10020000 0 0x7fe0000>,
                      <0x42000000 0 0x18000000 0x18000000 0 0x8000000>;
             bus-range = <0x00 0xff>;
             clocks = <&rcc CK_BUS_PCIE>;
             clock-names = "core";
             phys = <&combophy PHY_TYPE_PCIE>;
             phy-names = "pcie-phy";
             resets = <&rcc PCIE_R>;
             reset-names = "pcie";
             wakeup-source;
             wake-gpios = <&gpioh 5 GPIO_ACTIVE_LOW>;
             msi-parent = <&v2m0>;
    };
```

## Documentation/devicetree/bindings/phy/st,stm32-combophy.yaml
```yaml
# SPDX-License-Identifier: (GPL-2.0 OR BSD-2-Clause)
%YAML 1.2
---
$id: http://devicetree.org/schemas/phy/st,stm32-combophy.yaml#
$schema: http://devicetree.org/meta-schemas/core.yaml#

title: STMicroelectronics STM32MP25 USB3/PCIe ComboPHY binding.

maintainers:
  - Christian Bruel <christian.bruel@foss.st.com>

description: |
  Single lane PHY shared (exclusive) between the USB3 and PCIe controllers.
  Supports 5Gbit/s for USB3 and PCIe gen2 or 2.5Gbit/s for PCIe gen1.

properties:
  compatible:
    const: st,stm32mp25-combophy

  reg:
    maxItems: 1

  st,syscfg:
    $ref: /schemas/types.yaml#/definitions/phandle-array
    description: Phandle to the SYSCON entry required for configuring PCIe
      or USB3.

  "#phy-cells":
    const: 1
    description: |
      The cells contain the following arguments.

      - description: The PHY type
          enum:
            - PHY_TYPE_USB3
            - PHY_TYPE_PCIE

  clocks:
    anyOf:
      - description: apb-clk Bus clock mandatory to access registers.
      - description: ker-clk Internal RCC reference clock for USB3 or PCIe
      - description: pad-clk Optional on board clock input for PCIe only. Typically an
                     external 100Mhz oscillator wired on dedicated CLKIN pad. Used as reference
                     clock input instead of the ker-clk

  clock-names:
    oneOf:
      - items:
          - const: apb-clk
          - const: ker-clk

      - items:
          - const: apb-clk
          - const: ker-clk
          - const: pad-clk

  resets:
    maxItems: 1

  reset-names:
    const: phy-rst

  power-domains:
    maxItems: 1

  feature-domains:
    $ref: /schemas/types.yaml#/definitions/phandle-array
    description: |
      Phandle to the rifsc device to check access right.

  st,ssc-on:
    type: boolean
    description:
      A boolean property whose presence indicates that the SSC for common clock
      needs to be set.

  st,rx_equalizer:
    minimum: 0
    maximum: 7
    default: 2
    description:
      A 3 bit value describing internal filter settings for the RX equalizer.

  st,output-micro-ohms:
    minimum: 3999000
    maximum: 6090000
    default: 4968000
    description:
      A value property to tune the PCIe 100Mhz Single Ended Output Impedance, simulations
      results at 25C for a VDDP=0.8V.
      The hardware accepts discrete values in this range.

  st,output-vswing-microvolt:
    minimum: 442000
    maximum: 803000
    default: 803000
    description:
      A value property in microvolt to tune the PCIe 100Mhz differential Single Ended Output
      Voltage Swing to change the Vlo, Vhi for a VDDP = 0.8V.
      The hardware accepts discrete values in this range.

  wakeup-source: true

  interrupts:
    maxItems: 1
    description: interrupt used for wakeup

required:
  - compatible
  - reg
  - st,syscfg
  - '#phy-cells'
  - resets
  - reset-names
  - clocks
  - clock-names

allOf:
  - if:
      required:
        - wakeup-source
    then:
      anyOf:
        - required: [interrupts]
        - required: [interrupts-extended]

additionalProperties: false

examples:
  - |
    // Example 1: Combophy configured to use internal reference clock
    #include <dt-bindings/clock/stm32mp25-clks.h>
    #include <dt-bindings/reset/stm32mp25-resets.h>

    combophy_internal: phy@480c0000 {
              compatible = "st,stm32mp25-combophy";
              reg = <0x480c0000 0x1000>;
              #phy-cells = <1>;
              clocks = <&rcc CK_BUS_USB3PCIEPHY>, <&rcc CK_KER_USB3PCIEPHY>;
              clock-names = "apb-clk", "ker-clk";
              resets = <&rcc USB3PCIEPHY_R>;
              reset-names = "phy-rst";
              st,syscfg = <&syscfg>;
              wakeup-source;
              interrupts-extended = <&exti1 45 IRQ_TYPE_EDGE_FALLING>;
    };

  - |
    // Example 2: Combophy configured to use extrenal 100MHz reference clock
    // on CLKIN pad for PCIe
    #include <dt-bindings/clock/stm32mp25-clks.h>
    #include <dt-bindings/reset/stm32mp25-resets.h>

    clocks {
        pad_clk: pad-clk {
                #clock-cells = <0>;
                compatible = "fixed-clock";
                clock-frequency = <100000000>;
        };
    };

    combophy_pad: phy@480c0000 {
              compatible = "st,stm32mp25-combophy";
              reg = <0x480c0000 0x1000>;
              #phy-cells = <1>;
              clocks = <&rcc CK_BUS_USB3PCIEPHY>, <&rcc CK_KER_USB3PCIEPHY>, <&pad_clk>;
              clock-names = "apb-clk", "ker-clk", "pad-clk";
              resets = <&rcc USB3PCIEPHY_R>;
              reset-names = "phy-rst";
              st,syscfg = <&syscfg>;
              wakeup-source;
              interrupts-extended = <&exti1 45 IRQ_TYPE_EDGE_FALLING>;
    };
...
```
