## Documentation/devicetree/bindings/media/st,stm32mp25-vdec.yaml
```yaml
# SPDX-License-Identifier: (GPL-2.0 OR BSD-2-Clause)

%YAML 1.2
---
$id: http://devicetree.org/schemas/media/st,stm32mp25-vdec.yaml#
$schema: http://devicetree.org/meta-schemas/core.yaml#

title: STMicroelectronics STM32MP25 VDEC video decoder

maintainers:
  - Hugues Fruchet <hugues.fruchet@foss.st.com>

description:
  The STMicroelectronics STM32MP25 SOCs embeds a VDEC video hardware decoder
  peripheral based on Verisilicon VC8000NanoD IP (former Hantro G1).

properties:
  compatible:
    const: st,stm32mp25-vdec

  reg:
    maxItems: 1

  resets:
    maxItems: 1

  interrupts:
    maxItems: 1

  interrupt-names:
    maxItems: 1

  clocks:
    maxItems: 1

  clock-names:
    maxItems: 1

  power-domains:
    maxItems: 1

  feature-domains:
    $ref: /schemas/types.yaml#/definitions/phandle-array
    description: |
      Phandle to the rifsc device to check access right.

required:
  - compatible
  - reg
  - resets
  - interrupts
  - interrupt-names
  - clocks
  - clock-names

additionalProperties: false

examples:
  - |
    #include <dt-bindings/clock/stm32mp25-clks.h>
    #include <dt-bindings/interrupt-controller/arm-gic.h>
    #include <dt-bindings/reset/stm32mp25-resets.h>
    vdec: vdec@580d0000 {
        compatible = "st,stm32mp25-vdec";
        reg = <0x580d0000 0x3c8>;
        resets = <&rcc VDEC_R>;
        interrupt-names = "vdec";
        interrupts = <GIC_SPI 117 IRQ_TYPE_LEVEL_HIGH>;
        clock-names = "vdec-clk";
        clocks = <&rcc CK_BUS_VDEC>;
    };
```

## Documentation/devicetree/bindings/media/st,stm32mp25-venc.yaml
```yaml
# SPDX-License-Identifier: (GPL-2.0 OR BSD-2-Clause)

%YAML 1.2
---
$id: http://devicetree.org/schemas/media/st,stm32mp25-venc.yaml#
$schema: http://devicetree.org/meta-schemas/core.yaml#

title: STMicroelectronics STM32MP25 VENC video encoder

maintainers:
  - Hugues Fruchet <hugues.fruchet@foss.st.com>

description:
  The STMicroelectronics STM32MP25 SOCs embeds a VENC video hardware encoder
  peripheral based on Verisilicon VC8000NanoE IP (former Hantro H1).

properties:
  compatible:
    const: st,stm32mp25-venc

  reg:
    maxItems: 1

  resets:
    maxItems: 1

  interrupts:
    maxItems: 1

  interrupt-names:
    maxItems: 1

  clocks:
    maxItems: 1

  clock-names:
    maxItems: 1

  power-domains:
    maxItems: 1

  feature-domains:
    $ref: /schemas/types.yaml#/definitions/phandle-array
    description: |
      Phandle to the rifsc device to check access right.

required:
  - compatible
  - reg
  - resets
  - interrupts
  - interrupt-names
  - clocks
  - clock-names

additionalProperties: false

examples:
  - |
    #include <dt-bindings/clock/stm32mp25-clks.h>
    #include <dt-bindings/interrupt-controller/arm-gic.h>
    #include <dt-bindings/reset/stm32mp25-resets.h>
    venc: venc@580e0000 {
        compatible = "st,stm32mp25-venc";
        reg = <0x580e0000 0x800>;
        resets = <&rcc VENC_R>;
        interrupt-names = "venc";
        interrupts = <GIC_SPI 167 IRQ_TYPE_LEVEL_HIGH>;
        clock-names = "venc-clk";
        clocks = <&rcc CK_BUS_VENC>;
    };
```

## Documentation/devicetree/bindings/memory-controllers/st,stm32-omi.yaml
```yaml
# SPDX-License-Identifier: (GPL-2.0-only OR BSD-2-Clause)
%YAML 1.2
---
$id: http://devicetree.org/schemas/memory-controllers/st,stm32-omi.yaml#
$schema: http://devicetree.org/meta-schemas/core.yaml#

title: STM32 OSPI Memory Interface (OMI)

maintainers:
  - Patrice Chotard <patrice.chotard@foss.st.com>

description: |
  STM32 OSPI Memory Interface allows a SPI flash or HyperFlash connected to
  the SoC to be accessed via the external address space.

  The flash chip itself should be represented by a subnode of the STM32 OSPI
  Memory Interface node. The flash interface is selected based on the
  "compatible" property of this subnode:
  - if it contains "jedec,spi-nor", then SPI is used;
  - if it contains "spi-nand", then SPI is used.
  - if it contains "cfi-flash", then HyperFlash is used.

properties:
  compatible:
    items:
      - const: st,stm32mp25-omi

  reg:
    description: registers

  "#address-cells":
    enum: [1, 2]

  "#size-cells":
    enum: [0, 1]

  memory-region:
    description: Phandle to a node describing memory-map region to be used

  clocks:
    maxItems: 1

  interrupts:
    maxItems: 1

  resets:
    maxItems: 2

  dmas:
    description: tx and rx DMA channel
    minItems: 1
    maxItems: 2

  dma-names:
    items:
      enum: [tx, rx]
    minItems: 1
    maxItems: 2

  st,syscfg-dlyb:
    description: |
      Use to set the OSPI delay block within SYSCFG to:
        Tune the phase of the RX sampling clock (or DQS) in order
        to sample the data in their valid window.
        Tune the phase of the TX launch clock in order to meet setup
        and hold constraints of TX signals versus the memory clock.
    $ref: "/schemas/types.yaml#/definitions/phandle-array"
    items:
      minItems: 2
      maxItems: 2

  feature-domains:
    $ref: /schemas/types.yaml#/definitions/phandle-array
    description: |
      Phandle to the rifsc device to check access right.

  power-domains:
    maxItems: 1

required:
  - compatible
  - reg
  - "#address-cells"
  - "#size-cells"
  - clocks
  - interrupts
  - st,syscfg-dlyb

patternProperties:
  "flash@[0-9a-f]+$":
    type: object
    properties:
      compatible:
        oneOf:
          - items:
              - enum:
                  - cypress,hyperflash
              - const: cfi-flash
          - enum:
              - jedec,spi-nor
              - spi-nand
              - st,octal-bus

    allOf:
      - if:
          properties:
            compatible:
              enum:
                - jedec,spi-nor
                - spi-nand
                - st,octal-bus

        then:
          $ref: "/schemas/spi/spi-controller.yaml#"

      - if:
          properties:
            compatible:
              contains:
                enum:
                  - cfi-flash

        then:
          $ref: "/schemas/mtd/mtd-physmap.yaml#"

          properties:
            st,max-frequency:
              $ref: /schemas/types.yaml#/definitions/uint32
              description:
                Maximum clocking speed of the device in Hz.

            st,tacc-ns:
              description:
                Device initial access time.

            st,wzl:
              $ref: /schemas/types.yaml#/definitions/flag
              description:
                Enable write zero latency

          required:
            - st,max-frequency

      - if:
          properties:
            compatible:
              contains:
                enum:
                  - st,octal-bus

        then:
          required:
            - spi-max-frequency

additionalProperties: false

examples:
  - |
    #include <dt-bindings/interrupt-controller/arm-gic.h>
    #include <dt-bindings/bus/stm32mp25_sys_bus.h>
    #include <dt-bindings/clock/stm32mp25-clks.h>
    #include <dt-bindings/reset/stm32mp25-resets.h>
    spi@40430000 {
      compatible = "st,stm32mp25-omi";
      reg = <0x40430000 0x400>;
      memory-region = <&mm_ospi1>;
      interrupts = <GIC_SPI 163 IRQ_TYPE_LEVEL_HIGH>;
      dmas = <&hpdma 2 0x62 0x00003121 0x0>,
             <&hpdma 2 0x42 0x00003112 0x0>;
      dma-names = "tx", "rx";
      st,syscfg-dlyb = <&syscfg 0x1000>;
      clocks = <&scmi_clk CK_SCMI_OSPI1>;
      resets = <&scmi_reset RST_SCMI_OSPI1DLL>, <&scmi_reset RST_SCMI_OSPI1DLL>;
      feature-domains = <&rifsc STM32MP25_RIFSC_OCTOSPI1_ID>;
      power-domains = <&CLUSTER_PD>;

      #address-cells = <1>;
      #size-cells = <0>;

      flash@0 {
        compatible = "jedec,spi-nor";
        reg = <0>;
        spi-rx-bus-width = <4>;
        spi-max-frequency = <108000000>;
      };
    };

  - |
    #include <dt-bindings/interrupt-controller/arm-gic.h>
    #include <dt-bindings/bus/stm32mp25_sys_bus.h>
    #include <dt-bindings/clock/stm32mp25-clks.h>
    #include <dt-bindings/reset/stm32mp25-resets.h>
    memory-controller@40430000 {
      compatible = "st,stm32mp25-omi";
      reg = <0x40430000 0x400>;
      memory-region = <&mm_ospi1>;
      interrupts = <GIC_SPI 163 IRQ_TYPE_LEVEL_HIGH>;
      dmas = <&hpdma 2 0x42 0x00003013 0x0>;
      dma-names = "rx";
      st,syscfg-dlyb = <&syscfg 0x1000>;
      clocks = <&scmi_clk CK_SCMI_OSPI1>;
      resets = <&scmi_reset RST_SCMI_OSPI1>, <&scmi_reset RST_SCMI_OSPI1DLL>;
      feature-domains = <&rifsc STM32MP25_RIFSC_OCTOSPI1_ID>;
      power-domains = <&CLUSTER_PD>;

      #address-cells = <2>;
      #size-cells = <1>;

      flash@0 {
        compatible = "cypress,hyperflash", "cfi-flash";
        reg = <0x2 0x0 0x4000000>;
        st,max-frequency = <100000000>;
        st,tacc-ns = <48>;
      };
    };
  - |
    #include <dt-bindings/interrupt-controller/arm-gic.h>
    #include <dt-bindings/bus/stm32mp25_sys_bus.h>
    #include <dt-bindings/clock/stm32mp25-clks.h>
    #include <dt-bindings/reset/stm32mp25-resets.h>
    memory-controller@40430000 {
      compatible = "st,stm32mp25-omi";
      reg = <0x40430000 0x400>;
      memory-region = <&mm_ospi1>;
      interrupts = <GIC_SPI 163 IRQ_TYPE_LEVEL_HIGH>;
      dmas = <&hpdma 2 0x62 0x00003121 0x0>,
             <&hpdma 2 0x42 0x00003112 0x0>;
      dma-names = "tx", "rx";
      st,syscfg-dlyb = <&syscfg 0x1000>;
      clocks = <&scmi_clk CK_SCMI_OSPI1>;
      resets = <&scmi_reset RST_SCMI_OSPI1>, <&scmi_reset RST_SCMI_OSPI1DLL>;
      feature-domains = <&rifsc STM32MP25_RIFSC_OCTOSPI1_ID>;
      power-domains = <&CLUSTER_PD>;
      cs-gpios = <&gpiod 1 GPIO_ACTIVE_LOW>;

      #address-cells = <1>;
      #size-cells = <0>;

      flash@0 {
        compatible = "st,octal-bus";
        reg = <0>;
        spi-max-frequency = <50000000>;
      };
    };
```

## Documentation/devicetree/bindings/misc/st,stm32-omm.yaml
```yaml
# SPDX-License-Identifier: (GPL-2.0-only OR BSD-2-Clause)
%YAML 1.2
---
$id: http://devicetree.org/schemas/misc/st,stm32-omm.yaml#
$schema: http://devicetree.org/meta-schemas/core.yaml#

title: STM32 Octo Memory Manager (OMM)

maintainers:
  - Patrice Chotard <patrice.chotard@foss.st.com>

description: |
  The STM32 Octo Memory Manager is a low-level interface that enables an
  efficient OCTOSPI pin assignment with a full I/O matrix (before alternate
  function map) and multiplex of single/dual/quad/octal SPI interfaces over
  the same bus.

properties:
  compatible:
    const: st,stm32mp25-omm

  "#address-cells":
    const: 2

  "#size-cells":
    const: 1

  ranges:
    description: |
      Reflects the memory layout with four integer values per bank. Format:
      <bank-number> 0 <address of the bank> <size>

  reg:
    items:
      - description: registers
      - description: memory mapping

  reg-names:
    items:
      - const: omm
      - const: omm_mm

  memory-region:
    $ref: /schemas/types.yaml#/definitions/phandle-array
    description: Phandle to a node describing memory-map region to be used.

  memory-region-names:
    minItems: 1
    items:
      - const: mm_ospi1
      - const: mm_ospi2

  clocks:
    items:
      - description: Octo Memory Manager clock

  resets:
    items:
      - description: Octo Memory Manager reset

  feature-domains:
    $ref: /schemas/types.yaml#/definitions/phandle-array
    description: |
      Phandle to the rifsc device to check access right.

  st,syscfg-amcr:
    $ref: /schemas/types.yaml#/definitions/phandle-array
    description: |
      The Address Mapping Control Register (AMCR) is used to split the 256MB
      memory map area shared between the 2 OSPI Memory Interface (OMI). The Octo
      Memory Manager sets the AMCR depending of the memory-region configuration.
      Format is phandle to syscfg / register offset within syscfg / memory split
      bitmask.
    items:
      minItems: 3
      maxItems: 3

  st,omm-req2ack-ns:
    description: |
      In multiplexed mode (MUXEN = 1), this field defines the time in
      nanoseconds between two transactions.

  st,omm-cssel-ovr:
    $ref: /schemas/types.yaml#/definitions/uint32
    description: |
      Configure the chip select selector override for the 2 OCTOSPIs.
      The 2 bits mask muxing description is:
        -bit 0: Chip select selector override setting for OCTOSPI1
          0x0: the chip select signal from OCTOSPI1 is sent to NCS1
          0x1: the chip select signal from OCTOSPI1 is sent to NCS2
        -bit 1: Chip select selector override setting for OCTOSPI2
          0x0: the chip select signal from OCTOSPI2 is sent to NCS1
          0x1: the chip select signal from OCTOSPI2 is sent to NCS2

  st,omm-mux:
    $ref: /schemas/types.yaml#/definitions/uint32
    description: |
      Configure the muxing between the 2 OCTOSPIs busses and the 2 output ports.
      The muxing 2 bits mask description is:
        - 0x0: direct mode, default
        - 0x1: mux OCTOSPI1 and OCTOSPI2 to port 1
        - 0x2: swapped mode
        - 0x3: mux OCTOSPI1 and OCTOSPI2 to port 2

  power-domains:
    maxItems: 1

patternProperties:
  "^spi@[a-f0-9]+$":
    type: object
    $ref: "/schemas/memory-controllers/st,stm32-omi.yaml#"

  "^memory-controller@[a-f0-9]+$":
    type: object
    $ref: "/schemas/memory-controllers/st,stm32-omi.yaml#"

required:
  - compatible
  - reg
  - clocks
  - st,syscfg-amcr
  - ranges

additionalProperties: false

examples:
  - |
    #include <dt-bindings/interrupt-controller/arm-gic.h>
    #include <dt-bindings/bus/stm32mp25_sys_bus.h>
    #include <dt-bindings/clock/stm32mp25-clks.h>
    #include <dt-bindings/reset/stm32mp25-resets.h>

    ommanager@40500000 {
      #address-cells = <2>;
      #size-cells = <1>;
      compatible = "st,stm32mp25-omm";
      reg = <0x40500000 0x400>, <0x60000000 0x10000000>;
      reg-names = "omm", "omm_mm";
      memory-region = <&mm_ospi1>, <&mm_ospi2>;
      memory-region-names = "mm_ospi1", "mm_ospi2";
      clocks = <&rcc CK_BUS_OSPIIOM>;
      resets = <&rcc OSPIIOM_R>;
      st,syscfg-amcr = <&syscfg 0x2c00 0x7>;
      st,omm-req2ack-ns = <0x0>;
      st,omm-mux = <0x0>;
      st,omm-cssel-ovr = <0x0>;
      feature-domains = <&rifsc STM32MP25_RIFSC_OCTOSPIM_ID>;
      power-domains = <&CLUSTER_PD>;

      ranges = <0 0 0x40430000 0x400>,
               <1 0 0x40440000 0x400>;

      spi@40430000 {
        #address-cells = <1>;
        #size-cells = <0>;
        compatible = "st,stm32mp25-omi";
        reg = <0 0 0x400>;
        interrupts = <GIC_SPI 163 IRQ_TYPE_LEVEL_HIGH>;
        dmas = <&hpdma 2 0x62 0x00003121 0x0>,
               <&hpdma 2 0x42 0x00003112 0x0>;
        dma-names = "tx", "rx";
        st,syscfg-dlyb = <&syscfg 0x1000>;
        clocks = <&rcc CK_KER_OSPI1>;
        resets = <&rcc OSPI1_R>, <&rcc OSPI1DLL_R>;
        feature-domains = <&rifsc STM32MP25_RIFSC_OCTOSPI1_ID>;
        power-domains = <&CLUSTER_PD>;
      };

      memory-controller@40440000 {
        #address-cells = <1>;
        #size-cells = <0>;
        compatible = "st,stm32mp25-omi";
        reg = <1 0 0x400>;
        interrupts = <GIC_SPI 164 IRQ_TYPE_LEVEL_HIGH>;
        dmas = <&hpdma 3 0x62 0x00003121 0x0>,
               <&hpdma 3 0x42 0x00003112 0x0>;
        dma-names = "tx", "rx";
        st,syscfg-dlyb = <&syscfg 0x1400>;
        clocks = <&rcc CK_KER_OSPI2>;
        resets = <&rcc OSPI2_R>, <&rcc OSPI2DLL_R>;
        feature-domains = <&rifsc STM32MP25_RIFSC_OCTOSPI2_ID>;
        power-domains = <&CLUSTER_PD>;
      };
    };
```
