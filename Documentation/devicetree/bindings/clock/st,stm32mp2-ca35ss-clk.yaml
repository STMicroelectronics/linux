## Documentation/devicetree/bindings/usb/st,stm32-ucpd.yaml
```yaml
# SPDX-License-Identifier: (GPL-2.0 OR BSD-2-Clause)
%YAML 1.2
---
$id: http://devicetree.org/schemas/usb/st,stm32-ucpd.yaml#
$schema: http://devicetree.org/meta-schemas/core.yaml#

title: STM32 UCPD (USB Type-C and Power Delivery)

maintainers:
  - Christian Bruel <christian.bruel@foss.st.com>

description:
  STMicroelectronics USB Type-C and Power Delivery Port Controller

properties:
  compatible:
    const: st,stm32mp25-ucpd

  reg:
    maxItems: 1

  interrupts:
    maxItems: 1

  interrupt-names:
    const: ucpd

  clocks:
    items:
      - description: APB Bus clock
      - description: RCC kernel clock

  clock-names:
    items:
      - const: apb
      - const: ker

  resets:
    maxItems: 1

  reset-names:
    const: ucpd

  nvmem-cells:
    maxItems: 6
    description: Phandles to the trim values provided by otp

  nvmem-cell-names:
    maxItems: 6

  st,tcpp:
    $ref: /schemas/types.yaml#/definitions/phandle
    description:
      phandle to Type-C Port Protection companion chip.
      Refer to ./st,tcpp.yaml

  access-controllers:
    maxItems: 1

  power-domains:
    maxItems: 1

  ucpd-supply:
    description: phandle to the UCPD regulator supply.

  vconn-cc1-gpios:
    description: Vconn on CC1 gate enable GPIO.

  vconn-cc2-gpios:
    description: Vconn on CC2 gate enable GPIO.

  vconn-supply:
    description: phandle to the regulator supplying Vconn gates.

  connector:
    type: object
    $ref: ../connector/usb-connector.yaml#
    unevaluatedProperties: false
    description: USB Type-C connector properties.

required:
  - clocks
  - clock-names
  - compatible
  - connector
  - interrupts
  - interrupt-names
  - resets
  - reset-names
  - reg
  - st,tcpp

additionalProperties: false

examples:
  - |
    #include <dt-bindings/clock/st,stm32mp25-rcc.h>
    #include <dt-bindings/gpio/gpio.h>
    #include <dt-bindings/interrupt-controller/arm-gic.h>
    #include <dt-bindings/reset/st,stm32mp25-rcc.h>

    typec@480a0000 {
        compatible = "st,stm32mp25-ucpd";
        reg = <0x480a0000 0x400>;
        interrupts = <GIC_SPI 229 IRQ_TYPE_LEVEL_HIGH>;
        interrupt-names = "ucpd";
        clocks = <&rcc CK_BUS_USBTC>, <&rcc CK_KER_USBTC>;
        clock-names = "apb", "ker";
        resets = <&rcc USBTC_R>;
        reset-names = "ucpd";
        access-controllers = <&rifsc 69>;
        power-domains = <&d1_pd>;
        ucpd-supply = <&scmi_vdd33ucpd>;
        vconn-cc1-gpios = <&gpiof 5 GPIO_ACTIVE_HIGH>;
        vconn-cc2-gpios = <&gpioc 3 GPIO_ACTIVE_HIGH>;
        vconn-supply = <&vconn>;
        st,tcpp = <&tcpp03>;

        connector {
            compatible = "usb-c-connector";
            label = "USB-C";
            power-role = "dual";
            try-power-role = "sink";
            data-role = "dual";
            typec-power-opmode = "default";
            pd-disable;
            port {
                endpoint {
                    remote-endpoint = <&dwc3_ep>;
                };
            };
        };
    };
```

## Documentation/devicetree/bindings/usb/st,tcpp.yaml
```yaml
# SPDX-License-Identifier: (GPL-2.0 OR BSD-2-Clause)
%YAML 1.2
---
$id: http://devicetree.org/schemas/usb/st,tcpp.yaml#
$schema: http://devicetree.org/meta-schemas/core.yaml#

title: STMicroelectronics TCPP03 USB-C PD protection chip for DRP

maintainers:
  - Christian Bruel <christian.bruel@foss.st.com>

description:
  TCPP03 is a companion chip to interface and to protect USB-C DRP port.
  It has been developed to be used with STM32 family embedding UCPD controller.
  Access from I2C interface with 2 read registers SR1/SR2 and 1 CR register.

properties:
  compatible:
    const: st,tcpp03

  reg:
    description: I2C address
    maxItems: 1

  interrupts:
    maxItems: 1

  enable-gpios:
    description:
      GPIO pin connected to the TCPP_EN signal of the UCPD
    maxItems: 1

required:
  - compatible
  - reg

unevaluatedProperties: false

examples:
  - |
    #include <dt-bindings/interrupt-controller/irq.h>
    #include <dt-bindings/gpio/gpio.h>

    i2c {
        #address-cells = <1>;
        #size-cells = <0>;

        pinctrl-names = "default", "sleep";
        pinctrl-0 = <&i2c1_pins_a>;
        pinctrl-1 = <&i2c1_sleep_pins_a>;
        clock-frequency = <400000>;

        typec@34 {
            compatible = "st,tcpp03";
            reg = <0x34>;
            enable-gpios = <&gpiog 2 GPIO_ACTIVE_HIGH>;
            interrupt-parent = <&gpiog>;
            interrupts = <1 IRQ_TYPE_EDGE_FALLING>;
            pinctrl-names = "default";
            pinctrl-0 = <&tcpp_flgn_pins_a>;
        };
    };
```

## drivers/clk/stm32/Kconfig
```kconfig
# SPDX-License-Identifier: GPL-2.0-only
# common clock support for STMicroelectronics SoC family.

menuconfig COMMON_CLK_STM32MP
	bool "Clock support for common STM32MP clocks"
	depends on ARCH_STM32 || COMPILE_TEST
	default ARCH_STM32
	select RESET_CONTROLLER
	help
	  Support for STM32MP SoC family clocks.

if COMMON_CLK_STM32MP

config COMMON_CLK_STM32MP135
	bool "Clock driver for stm32mp13x clocks"
	depends on ARM || COMPILE_TEST
	default ARCH_STM32
	help
	  Support for stm32mp13x SoC family clocks.

config COMMON_CLK_STM32MP157
	bool "Clock driver for stm32mp15x clocks"
	depends on ARM || COMPILE_TEST
	default ARCH_STM32
	help
	  Support for stm32mp15x SoC family clocks.

config COMMON_CLK_STM32MP215
	bool "Clock driver for stm32mp21x clocks"
	depends on ARM64 || COMPILE_TEST
	default ARCH_STM32
	help
	  Support for stm32mp21x SoC family clocks

config COMMON_CLK_STM32MP257
	bool "Clock driver for stm32mp25x clocks"
	depends on ARM64 || COMPILE_TEST
	default ARCH_STM32
	help
	  Support for stm32mp25x SoC family clocks.

endif

config CLK_STM32MP2_CA35SS
    tristate "Clock controller for stm32mp2xx Cortex-A35 subsystem"
    depends on ARCH_STM32 || COMPILE_TEST
    help
      If you say yes here, you will get support for the Arm Cortex-A35 (CA35SS)
      clock controller in STM32MP2 family provided by secure monitor
      (TF-A BL31). This driver uses SMC calls to scale the frequency.
      This driver can also be built as a module.
```

## drivers/soc/st/Kconfig
```kconfig
if ARCH_STM32 || COMPILE_TEST

config STM32MP_PM_DOMAIN
	tristate "STM32MP PM domain"
	select PM_GENERIC_DOMAINS
	default y
	help
	  Enable support for the STM32MP Power Management (PM) domain driver.
	  This driver implements a generic PM domain for STM32MP SoCs, allowing
	  the kernel to manage power domains for various hardware blocks using
	  the generic power management framework. It is typically used to
	  control the power state of devices and peripherals on STM32MP
	  platforms. If unsure, say Y.

config STM32_HOG
	tristate "STM32 hog"
	default y
	help
	  Say Y here to enable the STM32 hog driver, which prepares and enables
	  a set of clocks very early during kernel initialization. The driver
	  retrieves all clocks referenced by its device node and keeps them
	  enabled for the whole lifetime of the platform device. This is
	  typically used to ensure that critical peripherals or SoC resources
	  remain clocked even if no functional driver has claimed them yet.

config STM32_PM_DOMAINS
	bool "STM32 PM domains"
	depends on MACH_STM32MP157
	select PM_GENERIC_DOMAINS
	default y if MACH_STM32MP157
	help
	  Enable support for STM32 Power Management (PM) domains.
	  This option allows the kernel to manage power domains on STM32MP157
	  platforms, providing runtime power management for various hardware
	  blocks. If unsure, say Y.

config STM32_RISAB
	tristate "STM32 RISAB"
	depends on ARM64 && DEBUG_FS
	default y
	help
	  Say y to enable RISAB dump debug helper driver. This creates an entry
	  in the debugfs to dump RISAB pages and blocks configurations. It
	  implicitly requires that the RISAB is clocked by a capable software
	  component.

config STM32_RISAF
	tristate "STM32 RISAF"
	depends on ARM64 && DEBUG_FS
	default y
	help
	  Say y to enable RISAF dump debug helper driver. This creates an entry
	  in the debugfs to dump RISAF memory regions configurations and
	  topology. It implicitly requires that the RISAF is clocked by a
	  capable software component.

endif # ARCH_STM32 || COMPILE_TEST
```
