## Documentation/devicetree/bindings/perf/st,stm32-ddr-pmu.yaml
```yaml
# SPDX-License-Identifier: (GPL-2.0-only OR BSD-2-Clause)
%YAML 1.2
---
$id: http://devicetree.org/schemas/perf/st,stm32-ddr-pmu.yaml#
$schema: http://devicetree.org/meta-schemas/core.yaml#

maintainers:
  - Clément Le Goffic <legoffic.clement@gmail.com>

title: STMicroelectronics STM32 DDR Performance Monitor (DDRPERFM)

properties:
  compatible:
    oneOf:
      - items:
          - const: st,stm32mp131-ddr-pmu
      - items:
          - enum:
              - st,stm32mp151-ddr-pmu
          - const: st,stm32mp131-ddr-pmu
      - items:
          - const: st,stm32mp251-ddr-pmu

  reg:
    maxItems: 1

  clocks:
    maxItems: 1

  resets:
    maxItems: 1

  access-controllers:
    minItems: 1
    maxItems: 2

  memory-channel:
    description:
      The memory channel this DDRPERFM is attached to.
    $ref: /schemas/types.yaml#/definitions/phandle

required:
  - compatible
  - reg

allOf:
  - if:
      properties:
        compatible:
          contains:
            const: st,stm32mp131-ddr-pmu
    then:
      required:
        - clocks
        - resets

  - if:
      properties:
        compatible:
          contains:
            const: st,stm32mp251-ddr-pmu
    then:
      required:
        - access-controllers
        - memory-channel

additionalProperties: false

examples:
  - |
    #include <dt-bindings/clock/stm32mp1-clks.h>
    #include <dt-bindings/reset/stm32mp1-resets.h>

    perf@5a007000 {
        compatible = "st,stm32mp151-ddr-pmu", "st,stm32mp131-ddr-pmu";
        reg = <0x5a007000 0x400>;
        clocks = <&rcc DDRPERFM>;
        resets = <&rcc DDRPERFM_R>;
    };

  - |
    ddr_channel: sdram-channel-0 {
        #address-cells = <1>;
        #size-cells = <0>;
        compatible = "jedec,ddr4-channel";
        io-width = <16>;
    };

    perf@48041000 {
      compatible = "st,stm32mp251-ddr-pmu";
      reg = <0x48041000 0x400>;
      access-controllers = <&rcc 104>;
      memory-channel = <&ddr_channel>;
    };
```

## Documentation/devicetree/bindings/remoteproc/rproc-srm.yaml
```yaml
# SPDX-License-Identifier: (GPL-2.0 OR BSD-2-Clause)
%YAML 1.2
---
$id: http://devicetree.org/schemas/remoteproc/rproc-srm.yaml#
$schema: http://devicetree.org/meta-schemas/core.yaml#

title: Remoteproc System Resource Manager

maintainers:
  - Arnaud Pouliquen <arnaud.pouliquen@foss.st.com>

description: |
  The remoteproc SRM (System Resource Manager) handles resources allocated
  to remote processors.
  This makes it possible to reserve some system resources for a peripheral
  assigned to a coprocessor.

properties:
  compatible:
    const: rproc-srm-core

  '#address-cells':
    const: 1

  '#size-cells':
    const: 1

$defs:
  rproc-srm-dev:
    type: object
    description:
      Peripheral resource node managed by SRM for the remote processor.
    properties:
      compatible:
        const: rproc-srm-dev

      reg:
        maxItems: 1

      clocks: true

      clock-names: true

      pinctrl-0: true

      pinctrl-names:
        items:
          - const: default

      interrupts: true

      interrupt-parent: true

      interrupt-names: true

    patternProperties:
      "^[a-zA-Z0-9-]+-supply$":
        $ref: /schemas/types.yaml#/definitions/phandle

    required:
      - compatible

    additionalProperties: true

required:
  - compatible

additionalProperties:
  $ref: "#/$defs/rproc-srm-dev"

examples:
  - |
    m4_rproc {
      m4_system_resources {
        #address-cells = <1>;
        #size-cells = <1>;
        status = "okay";

        button {
          compatible = "rproc-srm-dev";
          interrupt-parent = <&gpioa>;
          interrupts = <14 2>;
          interrupt-names = "irq";
          status = "okay";
        };

        sai4: sai@50027000 {
          compatible = "rproc-srm-dev";
          reg = <0x50027000 0x4>;
          clocks = <&rcc 0>;
          clock-names = "sai_ck";
          status = "disabled";
        };
      };
    };

...
```

## Documentation/devicetree/bindings/remoteproc/st,stm32-m0.yaml
```yaml
# SPDX-License-Identifier: (GPL-2.0 OR BSD-2-Clause)
%YAML 1.2
---
$id: http://devicetree.org/schemas/remoteproc/st,stm32-m0.yaml#
$schema: http://devicetree.org/meta-schemas/core.yaml#

title: STMicroelectronics STM32 remote processor controller for Cortex-M0+

description:
  This document defines the binding for the remoteproc component that loads and
  boots firmwares on the M0 of the smartrun domain on the ST32MP2 series.

maintainers:
  - Arnaud Pouliquen <arnaud.pouliquen@foss.st.com>

properties:
  compatible:
    enum:
      - st,stm32mp2-m0
    description:
      Use "st,stm32mp2-m0" for the stm32mp2 Cortex-M0 coprocessor management by Linux
  reg:
    maxItems: 1

  clocks: true

  clock-names: true

  resets:
    minItems: 1

  reset-names:
    items:
      - const: mcu_rst

  interrupts:
    description: Should contain the IWDG5 watchdog reset interrupt
    maxItems: 1

  wakeup-source: true

  mboxes:
    description:
      A channel (c) used by the local proc to notify the remote proc that it
      is about to be shut down.

  mbox-names:
    items:
      - const: shutdown

  memory-region:
    description:
      List of phandles to the reserved memory regions associated with the
      remoteproc device. This is variable and describes the memories shared with
      the remote processor (e.g. remoteproc firmware, shared memory for
      interprocessor communication ...).
      (see ../reserved-memory/reserved-memory.txt)

  st,auto-boot:
    $ref: /schemas/types.yaml#/definitions/flag
    description:
      If defined, when remoteproc is probed, it loads the default firmware and
      starts the remote processor.

required:
  - compatible
  - reg
  - clocks
  - resets
  - reset-names

additionalProperties: false

examples:
  - |
    #include <dt-bindings/clock/st,stm32mp25-rcc.h>
    #include <dt-bindings/reset/st,stm32mp25-rcc.h>

    m0_rproc: m0@0 {
      compatible = "st,stm32mp2-m0";
      reg = <0 0>;
      clocks = <&rcc CK_CPU3>;
      resets = <&rcc C3_R>;
      reset-names = "mcu_rst";
    };
...
```

## Documentation/devicetree/bindings/soc/st/st,stm32-hog.yaml
```yaml
# SPDX-License-Identifier: (GPL-2.0-only OR BSD-2-Clause)
%YAML 1.2
---
$id: http://devicetree.org/schemas/soc/st/st,stm32-hog.yaml#
$schema: http://devicetree.org/meta-schemas/core.yaml#

title: STMicroelectronics STM32 SoC hog driver

maintainers:
  - Gabriel Fernandez <gabriel.fernandez@foss.st.com>

description: |
  The STM32 hog driver is a simple helper used to enable and keep active
  a set of clocks on STM32 SoCs. All clocks referenced by the device node
  are retrieved at probe time, prepared and enabled, and then kept on
  until the driver is removed. This is typically used to guarantee that
  critical peripherals or SoC resources remain clocked even when no
  specific functional driver has been probed yet.
  Since this clock hog node does not represent a real device, it must be
  a sub-node of the root node and must be named 'clock-hog'.

properties:
  compatible:
    const: st,stm32-hog
  $nodename:
    const: clock-hog

  clocks:
    description: >
      List of clocks that must be enabled and kept running for the whole
      lifetime of the device. All referenced clocks will be acquired in
      bulk and enabled at probe time by the STM32 hog driver.
    minItems: 1
    maxItems: 32

  clock-names:
    description: >
      Optional names associated to the clocks. They are not strictly
      required by the driver but can be used to document the hardware
      and improve readability of the device tree.
    minItems: 1
    maxItems: 32

required:
  - compatible
  - clocks

additionalProperties: false

examples:
  - |
    / {
        model = "STMicroelectronics STM32MP157F-DK2 Discovery Board";
        compatible = "st,stm32mp157f-dk2", "st,stm32mp157";
        #address-cells = <1>;
        #size-cells = <1>;

        clock-hog {
            compatible = "st,stm32-hog";
            /*
            * All listed clocks will be enabled at boot time and
            * kept running as long as this device is present.
            */
            clocks = <&rcc 0>, <&rcc 1>;
            clock-names = "core", "per";
        };
    };
...
```

## Documentation/devicetree/bindings/soc/st/st,stm32mp25-risab.yaml
```yaml
# SPDX-License-Identifier: (GPL-2.0-only OR BSD-2-Clause)
%YAML 1.2
---
$id: http://devicetree.org/schemas/soc/st/st,stm32mp25-risab.yaml#
$schema: http://devicetree.org/meta-schemas/core.yaml#

title: STM32 Resource isolation peripheral unit for address space protection
       (block-based)

maintainers:
  - Gatien Chevallier <gatien.chevallier@foss.st.com>

description: |
  The RIF (resource isolation framework) is a comprehensive set of hardware
  blocks designed to enforce and manage isolation of STM32 hardware resources,
  like memory and peripherals.
  Through RISAB registers, a trusted domain, or the domain to whom the
  page configuration has been delegated, assigns memory pages to one or more
  security domains (secure, privilege, compartment).

properties:
  compatible:
    const: st,stm32mp25-risab

  reg:
    maxItems: 1

  clocks:
    maxItems: 1

  st,mem-map:
    $ref: /schemas/types.yaml#/definitions/uint32-array
    minItems: 2
    description:
      Defines the memory address range covered by the RISAB.

  memory-region:
    minItems: 1
    maxItems: 32
    description: |
      Phandle to a node describing memory areas to be configured by the RISAB.
      These regions cannot overlap. A zone must be within st,mem-map range and
      can be represented by one or more pages.

  st,srwiad:
    description: |
      When set, this bit allows secure read/write data accesses to non-secure
      blocks and pages (secure execute remains illegal).
    type: boolean

required:
  - compatible
  - reg
  - clocks
  - st,mem-map

additionalProperties: false

examples:
  - |
    #include <dt-bindings/clock/st,stm32mp25-rcc.h>
    risab1: risab@420f0000 {
      compatible = "st,stm32mp25-risab";
      reg = <0x420f0000 0x1000>;
      clocks = <&rcc CK_ICN_LS_MCU>;
      st,mem-map = <0xa000000 0x20000>;
      st,srwiad;
    };
```

## Documentation/devicetree/bindings/soc/st/stm32mp157c-pd.yaml
```yaml
# SPDX-License-Identifier: (GPL-2.0-only OR BSD-2-Clause)
%YAML 1.2
---
$id: http://devicetree.org/schemas/soc/st/stm32mp157c-pd.yaml#
$schema: http://devicetree.org/meta-schemas/core.yaml#

title: STM32MP1 power domain based on proprietary SMC

maintainers:
  - Patrick Delaunay <patrick.delaunay@foss.st.com>

deprecated: true

description: |
  STM32MP1 hierarchical power domain provider and based on proprietary SMC.

  This binding is used for backward compatibility. New platforms should use
  hierarchy of PSCI power domains and sub-domain with compatible
  'st,stm32mp-pm-domain'.

properties:
  compatible:
    const: st,stm32mp157c-pd

  '#address-cells':
    const: 1

  '#size-cells':
    const: 0

$defs:
  subdomain:
    type: object
    properties:
      reg:
        maxItems: 1

      '#power-domain-cells':
        const: 0

      '#address-cells':
        const: 1

      '#size-cells':
        const: 0

      label: true

    required:
      - reg
      - '#power-domain-cells'

    patternProperties:
      '^.*-power-domain@[0-9a-f]+$':
        $ref: '#/$defs/subdomain'

    additionalProperties: false

required:
  - compatible
  - '#address-cells'
  - '#size-cells'

patternProperties:
  '^.*-power-domain@[0-9a-f]+$':
    $ref: '#/$defs/subdomain'

additionalProperties: false

examples:
  - |
    pm_domain {
      #address-cells = <1>;
      #size-cells = <0>;
      compatible = "st,stm32mp157c-pd";

      pd_core_ret: core-ret-power-domain@1 {
        #address-cells = <1>;
        #size-cells = <0>;
        reg = <1>;
        #power-domain-cells = <0>;
        label = "CORE-RETENTION";

        pd_core: core-power-domain@2 {
          reg = <2>;
          #power-domain-cells = <0>;
          label = "CORE";
        };
      };
    };
```

## Documentation/devicetree/bindings/uio/uio-fwu-shmem.yaml
```yaml
# SPDX-License-Identifier: (GPL-2.0-only OR BSD-2-Clause)
%YAML 1.2
---
$id: http://devicetree.org/schemas/uio/uio-fwu-shmem.yaml#
$schema: http://devicetree.org/meta-schemas/core.yaml#

title: Userspace I/O (UIO) shared memory for Firmware Update (FWU)

maintainers:
  - Maxime Méré <maxime.mere@foss.st.com>

description:
  A memory-mapped region exported to userspace through the Linux UIO
  framework. It holds the Firmware Update (FWU) images that are used by
  the coprocessor's update agent. The node is bound to the generic UIO
  platform driver (uio_pdrv_genirq) through the
  "uio_pdrv_genirq.of_id=uio-fwu-shmem" kernel command line parameter.

properties:
  $nodename:
    pattern: "^uio-fwu-shmem(@[0-9a-f]+)?$"

  compatible:
    const: uio-fwu-shmem

  reg:
    maxItems: 1

required:
  - compatible
  - reg

additionalProperties: false

examples:
  - |
    soc {
        #address-cells = <2>;
        #size-cells = <2>;

        uio-fwu-shmem@81300000 {
            compatible = "uio-fwu-shmem";
            reg = <0x0 0x81300000 0x0 0x00a00000>;
        };
    };
```
