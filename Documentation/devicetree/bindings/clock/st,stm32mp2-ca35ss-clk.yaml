## Documentation/devicetree/bindings/clock/st,stm32mp2-ca35ss-clk.yaml
```yaml
# SPDX-License-Identifier: (GPL-2.0-only OR BSD-2-Clause)
%YAML 1.2
---
$id: http://devicetree.org/schemas/clock/st,stm32mp2-ca35ss-clk.yaml#
$schema: http://devicetree.org/meta-schemas/core.yaml#

title: STMicroelectronics CA35SS Clock Controller on STM32MP

maintainers:
  - Theo GOUREAU <theo.goureau@foss.st.com>

description: |
  This binding describes the clock controller provided by the secure monitor
  (TF-A BL31) which supplies the clock for the Cortex-A35 subsystem (CA35SS).
  The clock controller uses SMC calls for frequency scaling.

properties:
  compatible:
    const: st,stm32mp2-ca35ss-clk

  "#clock-cells":
    const: 0

required:
  - compatible
  - "#clock-cells"

additionalProperties: false

examples:
  - |
      ca35ss_clk: ca35ss-clk {
        compatible = "st,stm32mp2-ca35ss-clk";
        #clock-cells = <0>;
      };
...
```

## Documentation/devicetree/bindings/cpufreq/stm32-cpufreq.txt
```
STM32 CPUFreq and OPP bindings
==============================

STM32 CPUFreq driver needs to read chip information from the SoC to list
available OPPs. Then it depends on cpufreq-dt bindings.

Required properties:
--------------------
- clocks: Phandle to the cpu clock "cpu".
- clocks-name: Should contain "cpu".
- nvmem-cells: Phandle to nvmem cell that contains "cpu_speed_grade".
- nvmem-cell-names: Must be "speed_grade".
- operating-points-v2: Phandle to operating points table. See ../power/opp.txt
  for more details.

Optional properties:
--------------------
See cpufreq-dt.txt for optional properties.

Examples:
---------
	cpus {
		#address-cells = <1>;
		#size-cells = <0>;

		cpu0: cpu@0 {
			compatible = "arm,cortex-a7";
			device_type = "cpu";
			reg = <0>;
			clocks = <&rcc CK_MPU>;
			clock-names = "cpu";
			operating-points-v2 = <&cpu0_opp_table>;
			nvmem-cells = <&cpu_speed_grade>;
			nvmem-cell-names = "speed_grade";
		};

		cpu1: cpu@1 {
			compatible = "arm,cortex-a7";
			device_type = "cpu";
			reg = <1>;
			clocks = <&rcc CK_MPU>;
			clock-names = "cpu";
			operating-points-v2 = <&cpu0_opp_table>;
		};
	};

	cpu0_opp_table: cpu0-opp-table {
		compatible = "operating-points-v2";
		opp-shared;

		opp-650000000 {
			opp-hz = /bits/ 64 <650000000>;
			opp-microvolt = <1200000>;
			opp-supported-hw = <0x3>;
		};
		opp-800000000 {
			opp-hz = /bits/ 64 <800000000>;
			opp-microvolt = <1350000>;
			opp-supported-hw = <0x2>;
		};
	};
```

## Documentation/devicetree/bindings/hwlock/st,stm32-hwspinlock.yaml
```yaml
# SPDX-License-Identifier: (GPL-2.0-only OR BSD-2-Clause)
%YAML 1.2
---
$id: http://devicetree.org/schemas/hwlock/st,stm32-hwspinlock.yaml#
$schema: http://devicetree.org/meta-schemas/core.yaml#

title: STMicroelectronics STM32 Hardware Spinlock

maintainers:
  - Fabien Dessenne <fabien.dessenne@foss.st.com>
  - Antonio Borneo <antonio.borneo@foss.st.com>

properties:
  "#hwlock-cells":
    const: 2
    description:
      Multiple consumers of the STM32 Hardware Spinlock can share the same
      hwlock; each consumer has to use a unique ProcID for that hwlock.
      The first cell is the index of the hwlock in the device.
      The second cell is the ProcID of the consumer for such hwlock.

  compatible:
    const: st,stm32-hwspinlock

  reg:
    maxItems: 1

  clocks:
    maxItems: 1

  clock-names:
    items:
      - const: hsem

required:
  - "#hwlock-cells"
  - compatible
  - reg
  - clocks
  - clock-names

additionalProperties: false

examples:
  - |
    #include <dt-bindings/clock/stm32mp1-clks.h>
    hwspinlock@4c000000 {
        compatible = "st,stm32-hwspinlock";
        #hwlock-cells = <2>;
        reg = <0x4c000000 0x400>;
        clocks = <&rcc HSEM>;
        clock-names = "hsem";
    };

    pinctrl@50002000 {
        compatible = "st,stm32mp157-pinctrl";
        #address-cells = <1>;
        #size-cells = <1>;
        ranges = <0 0x50002000 0xa400>;
        hwlocks = <&hsem 0 0>;
    };

    pinctrl@54004000 {
        compatible = "st,stm32mp157-z-pinctrl";
        #address-cells = <1>;
        #size-cells = <1>;
        ranges = <0 0x54004000 0x400>;
        hwlocks = <&hsem 0 1>;
    };

...
```

## Documentation/devicetree/bindings/interrupt-controller/rpmsg,intc.yaml
```yaml
# SPDX-License-Identifier: (GPL-2.0-only OR BSD-2-Clause)
# Copyright (c) 2023 STMicroelectronics.
%YAML 1.2
---
$id: http://devicetree.org/schemas/interrupt-controller/rpmsg,intc.yaml#
$schema: http://devicetree.org/meta-schemas/core.yaml#

title: RPMSG Interrupt controller

maintainers:
  - Arnaud Pouliquen <arnaud.pouliquen@foss.st.com>

allOf:
  - $ref: /schemas/interrupt-controller.yaml#

description:
  RPMsg interrupt controller for interprocessor communication based on interrupt signaling

properties:
  compatible:
    const: rpmsg,intc

  reg:
    maxItems: 1

  '#interrupt-cells':
    const: 1

  interrupt-controller: true

required:
  - compatible
  - '#interrupt-cells'
  - interrupt-controller

additionalProperties: false

examples:
  - |
    intc_rpmsg: interrupt-controller@1 {
        compatible = "rpmsg,intc";
        reg = <1 0>;
        #interrupt-cells = <1>;
        interrupt-controller;
    };
```

## Documentation/devicetree/bindings/mailbox/mbox-cdev.yaml
```yaml
# SPDX-License-Identifier: (GPL-2.0 OR BSD-2-Clause)
%YAML 1.2
---
$id: http://devicetree.org/schemas/mailbox/mbox-cdev.yaml#
$schema: http://devicetree.org/meta-schemas/core.yaml#

title: Mailbox Character Device

description: |
  This binding describes a mailbox character device that uses a mailbox
  framework and a memory region to communicate with a remote processor.

maintainers:
  - Arnaud Pouliquen <arnaud.pouliquen@foss.st.com>

properties:
  compatible:
    const: mbox-cdev

  reg:
    maxItems: 1

  memory-region:
    description: |
      Phandle to the reserved memory region used for communication with the
      coprocessor.
    $ref: /schemas/types.yaml#/definitions/phandle

  mboxes:
    description: |
      phandles to the mailbox channel used for communication.
    maxItems: 1

  mbox-names:
    items:
      - const: rx-tx

required:
  - compatible
  - reg
  - memory-region
  - mboxes

additionalProperties: false

examples:
  - |
    reserved-memory {
      #address-cells = <1>;
      #size-cells = <1>;
      ranges;

      memory_region: memory-region@20000000 {
        reg = <0x20000000 0x10000>;
        no-map;
      };
    };

    mbox_client: mailbox-client@0 {
      compatible = "mbox-cdev";
      reg = <1 0>;
      memory-region = <&memory_region>;
      mboxes = <&mailbox0>;
    };
```

## Documentation/devicetree/bindings/mfd/st,stm32mp1-pwr.yaml
```yaml
# SPDX-License-Identifier: (GPL-2.0-only OR BSD-2-Clause)
%YAML 1.2
---
$id: http://devicetree.org/schemas/mfd/st,stm32mp1-pwr.yaml#
$schema: http://devicetree.org/meta-schemas/core.yaml#

title: STMicroelectronics STM32MP1 Power Management Controller

description: |
  The PWR IP is responsible for handling power-related resources such as
  clocks, power supplies, and resets.

  It provides 6 wake-up pins handled by an interrupt controller. These
  wake-up pins can be used to wake up the SoC from the STANDBY state.

maintainers:
  - Pascal Paillet <p.paillet@foss.st.com>

deprecated: true

properties:
  compatible:
    items:
      - const: st,stm32mp1-pwr

  reg:
    maxItems: 1

  interrupts:
    maxItems: 1
    description: Reference to the GIC wake-up pin interrupt.

  interrupt-controller: true

  "#interrupt-cells":
    const: 3
    description: |
      Interrupt specifier cells:
        - cell 1: wake-up pin id from 0 to 5
        - cell 2: IRQ trigger type
        - cell 3: pull configuration
          - 0: no pull
          - 1: pull-up
          - 2: pull-down

  st,wakeup-pins:
    $ref: /schemas/types.yaml#/definitions/phandle-array
    description: List of GPIO specifiers describing each wake-up pin.

required:
  - compatible
  - reg
  - interrupts
  - interrupt-controller
  - "#interrupt-cells"
  - st,wakeup-pins

additionalProperties: false

examples:
  - |
    #include <dt-bindings/interrupt-controller/arm-gic.h>
    #include <dt-bindings/interrupt-controller/irq.h>
    #include <dt-bindings/gpio/gpio.h>

    pwr_irq: pwr@50001020 {
      compatible = "st,stm32mp1-pwr";
      reg = <0x50001020 0x100>;
      interrupts = <GIC_SPI 149 IRQ_TYPE_LEVEL_HIGH>;
      interrupt-controller;
      #interrupt-cells = <3>;

      st,wakeup-pins = <&gpioa 0 GPIO_ACTIVE_HIGH>,
                        <&gpioa 2 GPIO_ACTIVE_HIGH>,
                        <&gpioc 13 GPIO_ACTIVE_HIGH>,
                        <&gpioi 8 GPIO_ACTIVE_HIGH>,
                        <&gpioi 11 GPIO_ACTIVE_HIGH>,
                        <&gpioc 1 GPIO_ACTIVE_HIGH>;
      };
...
```

## Documentation/devicetree/bindings/net/st,stm32-deip.yaml
```yaml
# SPDX-License-Identifier: (GPL-2.0-only OR BSD-2-Clause)
%YAML 1.2
---
$id: http://devicetree.org/schemas/net/st,stm32-deip.yaml#
$schema: http://devicetree.org/meta-schemas/core.yaml#

title: STMicroelectronics STM32 DEIP TSN switch wrapper

maintainers:
  - Christophe Roullier <christophe.roullier@foss.st.com>

description: |
  This file documents platform glue layer for the STM32MP25 TSN switch wrapper node used with
  external TTTech modules.

select:
  properties:
    compatible:
      contains:
        const: st,stm32-deip
  required:
    - compatible

properties:
  compatible:
    const: st,stm32-deip

additionalProperties: true

examples:
  - |
    / {
        #address-cells = <1>;
        #size-cells = <1>;

        rcc: clock-controller {
            #clock-cells = <1>;
        };

        syscfg: syscon@44230000 {
            compatible = "syscon";
            reg = <0x44230000 0x1000>;
        };

        ttt_sw@4c000000 {
            #address-cells = <1>;
            #size-cells = <1>;
            compatible = "st,stm32-deip";
            clock-names = "ethsw-bus-clk", "ethsw-clk", "ethsw-ref-clk",
                          "ethswacmcfg-bus-clk", "ethswacmmsg-bus-clk";
            clocks = <&rcc 97>, <&rcc 322>, <&rcc 323>, <&rcc 341>, <&rcc 342>;
            st,syscon = <&syscfg 0x3800>;
            ranges = <0x4c000000 0x4c000000 0x2000000>,
                     <0x4b000000 0x4b000000 0xc0000>;
        };
    };

...
```

## Documentation/devicetree/bindings/net/ttt,acm-4.0.yaml
```yaml
# SPDX-License-Identifier: (GPL-2.0-only OR BSD-2-Clause)
%YAML 1.2
---
$id: http://devicetree.org/schemas/net/ttt,acm-4.0.yaml#
$schema: http://devicetree.org/meta-schemas/core.yaml#

title: TTTech ACM (ACceleration Module)

maintainers:
  - Christophe Roullier <christophe.roullier@foss.st.com>

description: |
  This file documents schema for TTTech ACM node referenced by STM32MP25
  device trees.

select:
  properties:
    compatible:
      contains:
        const: ttt,acm-4.0
  required:
    - compatible

properties:
  compatible:
    const: ttt,acm-4.0

additionalProperties: true

examples:
  - |
    / {
        #address-cells = <1>;
        #size-cells = <1>;

        ttt_sw@4c000000 {
            #address-cells = <1>;
            #size-cells = <1>;
            compatible = "st,stm32-deip";
            ranges = <0x4b000000 0x4b000000 0xc0000>;
            status = "disabled";

            deip_sw0: deip-sw {
                compatible = "ttt,deip-sw";
            };

            acm@4b000000 {
                compatible = "ttt,acm-4.0";
                reg = <0x4b000000 0x00400>,
                      <0x4b010000 0x10000>,
                      <0x4b030000 0x10000>,
                      <0x4b050000 0x10000>,
                      <0x4b060000 0x20000>,
                      <0x4b080000 0x40000>;
                reg-names = "CommonRegister", "Bypass1", "Bypass0", "Redundancy",
                            "Scheduler", "Messagebuffer";
                buffers = <32>;
                ptp_worker = <&deip_sw0>;
            };
        };
    };

...
```

## Documentation/devicetree/bindings/net/ttt,deip-sw.yaml
```yaml
# SPDX-License-Identifier: (GPL-2.0-only OR BSD-2-Clause)
%YAML 1.2
---
$id: http://devicetree.org/schemas/net/ttt,deip-sw.yaml#
$schema: http://devicetree.org/meta-schemas/core.yaml#

title: TTTech DEIP switch node

maintainers:
  - Christophe Roullier <christophe.roullier@foss.st.com>

description: |
  This file documents schema for TTTech DEIP switch node referenced by STM32MP25
  device trees.

select:
  properties:
    compatible:
      contains:
        const: ttt,deip-sw
  required:
    - compatible

properties:
  compatible:
    const: ttt,deip-sw

additionalProperties: true

examples:
  - |
    / {
    #address-cells = <1>;
    #size-cells = <1>;

      intc: interrupt-controller {
         interrupt-controller;
         #interrupt-cells = <3>;
      };

      ttt_sw@4c000000 {
         #address-cells = <1>;
         #size-cells = <1>;
         compatible = "st,stm32-deip";
         ranges = <0x4c000000 0x4c000000 0x2000000>;

         deip_sw0: deip-sw@4c000000 {
           compatible = "ttt,deip-sw";
           reg = <0x4c000000 0x2000000>;
           interrupt-parent = <&intc>;
           interrupts = <0 250 4>;
         };
      };
    };

...
```

## Documentation/devicetree/bindings/nvmem/st,stm32-tamp-nvram.yaml
```yaml
# SPDX-License-Identifier: (GPL-2.0-only OR BSD-2-Clause)
%YAML 1.2
---
$id: http://devicetree.org/schemas/nvmem/st,stm32-tamp-nvram.yaml#
$schema: http://devicetree.org/meta-schemas/core.yaml#

title: STMicroelectronics STM32 backup registers as NVMEM

description: |
  This represents STM32 backup registers area presented as nvmem cells.
  This contains various information (e.g. boot mode passed to bootloaders).

maintainers:
  - Siméon Marijon <simeon.marijon@foss.st.com>

allOf:
  - $ref: nvmem.yaml#

properties:
  compatible:
    enum:
      - st,stm32mp15-tamp-nvram
      - st,stm32mp25-tamp-nvram

  reg:
    description:
      TAMP Registers bank location and size.
    maxItems: 1

required:
  - compatible
  - reg

unevaluatedProperties: false

examples:
  - |
    nvram: nvram@5c00a100 {
      reg = <0x5c00a100 0x80>;
      compatible = "st,stm32mp15-tamp-nvram";

      nvmem-layout {
        compatible = "fixed-layout";
        #address-cells = <1>;
        #size-cells = <1>;

        /* Data cells */
        wakeup_sec: tamp-bkp@0 {
            reg = <0x0 0x4>;
        };
        boot_mode: tamp-bkp@50 {
            /*see boot mode selection feature*/
            reg = <0x50 0x4>;
        };
      };
    };
```
