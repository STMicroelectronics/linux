// SPDX-License-Identifier: (GPL-2.0-only OR BSD-3-Clause)
/*
 * Copyright (C) STMicroelectronics 2026 - All Rights Reserved
 * Author: Patrick Delaunay <patrick.delaunay@foss.st.com> for STMicroelectronics.
 */

&cryp1 {
	clocks = <&scmi_clk CK_SCMI_CRYP1>;
	resets = <&scmi_reset RST_SCMI_CRYP1>;
	post-init-providers = <&scmi_clk>, <&scmi_reset>;
	power-domains = <&d1_pd>;
};
