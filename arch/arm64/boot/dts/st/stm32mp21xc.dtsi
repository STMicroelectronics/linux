// SPDX-License-Identifier: (GPL-2.0-only OR BSD-3-Clause)
/*
 * Copyright (C) STMicroelectronics 2026 - All Rights Reserved
 * Author: Alexandre Torgue <alexandre.torgue@foss.st.com> for STMicroelectronics.
 */

&rifsc {
	cryp1: crypto@42030000 {
		compatible = "st,stm32mp1-cryp";
		reg = <0x42030000 0x0 0x400>;
		interrupts = <GIC_SPI 131 IRQ_TYPE_LEVEL_HIGH>;
		clocks = <&rcc CK_BUS_CRYP1>;
		resets = <&rcc CRYP1_R>;
		dmas = <&hpdma 4 0x40 0x3021>,
		       <&hpdma 5 0x43 0x3012>;
		dma-names = "mem2cryp", "cryp2mem";
		access-controllers = <&rifsc 98>;
		power-domains = <&d1_pd>;
		status = "disabled";
	};

	cryp2: crypto@42040000 {
		compatible = "st,stm32mp1-cryp";
		reg = <0x42040000 0x0 0x400>;
		interrupts = <GIC_SPI 157 IRQ_TYPE_LEVEL_HIGH>;
		clocks = <&rcc CK_BUS_CRYP2>;
		resets = <&rcc CRYP2_R>;
		dmas = <&hpdma 108 0x40 0x3021>,
		       <&hpdma 109 0x43 0x3012>;
		dma-names = "mem2cryp", "cryp2mem";
		access-controllers = <&rifsc 99>;
		power-domains = <&d1_pd>;
		status = "disabled";
	};
};
